#include <behaviors.dtsi>
#include <dt-bindings/zmk/mouse.h>
#include <dt-bindings/zmk/bt.h>
#include <dt-bindings/zmk/keys.h>
#include <dt-bindings/zmk/outputs.h>

// DIFFICULTY_LEVEL specifies your level of expertise with this keymap.
// It's meant to help newcomers gradually work their way up to mastery.
// You can disable this setting by omitting it or assigning a `0` zero.
//
// #define DIFFICULTY_LEVEL 0 // custom (see defaults below)
// #define DIFFICULTY_LEVEL 1 // novice (500ms)
// #define DIFFICULTY_LEVEL 2 // slower (400ms)
// #define DIFFICULTY_LEVEL 3 // normal (300ms)
// #define DIFFICULTY_LEVEL 4 // faster (200ms)
// #define DIFFICULTY_LEVEL 5 // expert (100ms)
//
#if defined(DIFFICULTY_LEVEL) && DIFFICULTY_LEVEL > 0
#define DIFFICULTY_THRESHOLD ((6-DIFFICULTY_LEVEL)*100)
#define HOMEY_HOLDING_TIME DIFFICULTY_THRESHOLD
#define INDEX_HOLDING_TIME DIFFICULTY_THRESHOLD
#define PLAIN_HOLDING_TIME DIFFICULTY_THRESHOLD
#define SPACE_HOLDING_TIME DIFFICULTY_THRESHOLD
#endif

//////////////////////////////////////////////////////////////////////////
//
// Miryoku layers and home row mods (ported from my QMK endgame)
// - https://sunaku.github.io/home-row-mods.html#porting-to-zmk
// - https://github.com/urob/zmk-config#timeless-homerow-mods
//
//////////////////////////////////////////////////////////////////////////

//
// ENFORCE_BILATERAL cancels out single-handed home row mods activation by
// releasing any currently pressed mods and replacing them with plain taps.
//
// NOTE: You may still encounter "flashing mods" where an operating system
// action is triggered by the release of mods, such as LGUI which launches
// the Windows Start Menu and LALT which opens the Microsoft Office Ribbon.
//
//#define ENFORCE_BILATERAL

//
// The *_FINGER_MOD specify which modifiers are used by home row mod keys.
// Here, we use Miryoku's "GACS" (Win, Alt, Ctrl, Shift) order by default,
// unless OPERATING_SYSTEM is macOS, in which case Win & Ctrl are swapped.
//
#ifndef PINKY_FINGER_MOD
  #define PINKY_FINGER_MOD LSFT
#endif
#ifndef RING_FINGER_MOD
  #define RING_FINGER_MOD LCTL
#endif
#ifndef MIDDY_FINGER_MOD
  #define MIDDY_FINGER_MOD LALT
#endif
#ifndef INDEX_FINGER_MOD
  #define INDEX_FINGER_MOD LGUI
#endif
//
// The following settings let you configure mods individually, per finger:
//
#ifndef LEFT_PINKY_MOD
#define LEFT_PINKY_MOD  LSFT
#endif
#ifndef RIGHT_PINKY_MOD
#define RIGHT_PINKY_MOD RSFT
#endif
#ifndef LEFT_RING_MOD
#define LEFT_RING_MOD  LCTL
#endif
#ifndef RIGHT_RING_MOD
#define RIGHT_RING_MOD RCTL
#endif
#ifndef LEFT_MIDDY_MOD
#define LEFT_MIDDY_MOD  LALT
#endif
#ifndef RIGHT_MIDDY_MOD
#define RIGHT_MIDDY_MOD LALT
#endif
#ifndef LEFT_INDEX_MOD
#define LEFT_INDEX_MOD  LGUI
#endif
#ifndef RIGHT_INDEX_MOD
#define RIGHT_INDEX_MOD RGUI
#endif

//
// HOMEY_HOLDING_TYPE defines the flavor of ZMK hold-tap behavior to use
// for the pinky, ring, and middle fingers (which are assigned to Super,
// Alt, and Ctrl respectively in the Miryoku system) on home row keys.
//
#ifndef HOMEY_HOLDING_TYPE
#define HOMEY_HOLDING_TYPE "tap-preferred"
#endif

//
// HOMEY_HOLDING_TIME defines how long you need to hold (milliseconds)
// home row mod keys in order to send their modifiers to the computer
// (i.e. "register" them) for mod-click mouse usage (e.g. Ctrl-Click).
//
#ifndef HOMEY_HOLDING_TIME
#define HOMEY_HOLDING_TIME 270 // TAPPING_TERM + ALLOW_CROSSOVER_AFTER
#endif

//
// HOMEY_STREAK_DECAY defines how long you need to wait (milliseconds)
// after typing before you can use home row mods again.  It prevents
// unintended activation of home row mods when you're actively typing.
//
#ifndef HOMEY_STREAK_DECAY
#define HOMEY_STREAK_DECAY 250
#endif

//
// HOMEY_REPEAT_DECAY defines how much time you have left (milliseconds)
// after tapping a key to hold it again in order to make it auto-repeat.
//
#ifndef HOMEY_REPEAT_DECAY
#define HOMEY_REPEAT_DECAY 300 // "tap then hold" for key auto-repeat
#endif

//
// CHORD_HOLDING_TYPE defines the flavor of ZMK hold-tap behavior to use
// for chorded home row mods (secondary keypresses in multi-mod chords).
//
#ifndef CHORD_HOLDING_TYPE
#define CHORD_HOLDING_TYPE HOMEY_HOLDING_TYPE
#endif

//
// CHORD_HOLDING_TIME defines how long you need to hold (milliseconds)
// home row mod keys in order to send their modifiers to the computer
// (i.e. "register" them) for mod-click mouse usage (e.g. Ctrl-Click).
// This is specifically for secondary keypresses in multi-mod chords.
//
#ifndef CHORD_HOLDING_TIME
#define CHORD_HOLDING_TIME 150
#endif

//
// CHORD_STREAK_DECAY defines how long you need to wait (milliseconds)
// after typing before you can use home row mods again.  It prevents
// unintended activation of home row mods when you're actively typing
// This is specifically for secondary keypresses in multi-mod chords.
//
#ifndef CHORD_STREAK_DECAY
#define CHORD_STREAK_DECAY HOMEY_STREAK_DECAY
#endif

//
// CHORD_REPEAT_DECAY defines how much time you have left (milliseconds)
// after tapping a key to hold it again in order to make it auto-repeat.
// This is specifically for secondary keypresses in multi-mod chords.
//
#ifndef CHORD_REPEAT_DECAY
#define CHORD_REPEAT_DECAY HOMEY_REPEAT_DECAY
#endif

//
// INDEX_HOLDING_TYPE defines the flavor of ZMK hold-tap behavior to use
// for index fingers (which Miryoku assigns to Shift) on home row keys.
//
// NOTE: The "tap-preferred" flavor of ZMK hold-tap for index finger keys
// allows faster activation of the Shift modifier (without having to wait
// for the modified key to be released as the "balanced" flavor requires).
// Typing streaks and the `hold-trigger-on-release` setting are disabled
// for the index fingers so as not to hinder their speed and dexterity.
//
#ifndef INDEX_HOLDING_TYPE
#define INDEX_HOLDING_TYPE "tap-preferred"
#endif

//
// INDEX_HOLDING_TIME defines how long you need to hold (milliseconds)
// index finger keys in order to send their modifiers to the computer
// (i.e. "register" them) for mod-click mouse usage (e.g. Shift-Click).
//
#ifndef INDEX_HOLDING_TIME
#define INDEX_HOLDING_TIME 170
#endif

//
// INDEX_STREAK_DECAY defines how long you need to wait (milliseconds)
// after typing before you can use home row mods again.  It prevents
// unintended activation of home row mods when you're actively typing.
//
#ifndef INDEX_STREAK_DECAY
#define INDEX_STREAK_DECAY 150
#endif

//
// INDEX_REPEAT_DECAY defines how much time you have left (milliseconds)
// after tapping a key to hold it again in order to make it auto-repeat.
//
#ifndef INDEX_REPEAT_DECAY
#define INDEX_REPEAT_DECAY 300 // "tap then hold" for key auto-repeat
#endif

//
// PLAIN_HOLDING_TYPE defines the flavor of ZMK hold-tap behavior to use
// for index fingers (which Miryoku assigns to Shift) on home row keys.
//
// NOTE: The "tap-preferred" flavor of ZMK hold-tap for index finger keys
// allows faster activation of the Shift modifier (without having to wait
// for the modified key to be released as the "balanced" flavor requires).
// Typing streaks and the `hold-trigger-on-release` setting are disabled
// for the index fingers so as not to hinder their speed and dexterity.
//
#ifndef PLAIN_HOLDING_TYPE
#define PLAIN_HOLDING_TYPE HOMEY_HOLDING_TYPE
#endif

//
// PLAIN_HOLDING_TIME defines how long you need to hold (milliseconds)
// index finger keys in order to send their modifiers to the computer
// (i.e. "register" them) for mod-click mouse usage (e.g. Shift-Click).
//
#ifndef PLAIN_HOLDING_TIME
#define PLAIN_HOLDING_TIME HOMEY_HOLDING_TIME
#endif

//
// PLAIN_STREAK_DECAY defines how long you need to wait (milliseconds)
// after typing before you can use home row mods again.  It prevents
// unintended activation of home row mods when you're actively typing.
//
#ifndef PLAIN_STREAK_DECAY
#define PLAIN_STREAK_DECAY HOMEY_STREAK_DECAY
#endif

//
// PLAIN_REPEAT_DECAY defines how much time you have left (milliseconds)
// after tapping a key to hold it again in order to make it auto-repeat.
//
#ifndef PLAIN_REPEAT_DECAY
#define PLAIN_REPEAT_DECAY 300 // "tap then hold" for key auto-repeat
#endif

//
// THUMB_HOLDING_TYPE defines the flavor of ZMK hold-tap behavior to use
// for the thumbs (which are assigned to 6 layers in the Miryoku system).
//
// NOTE: The "balanced" flavor of ZMK hold-tap provides instant modifier
// activation for the symbol layer (if the tapped symbol key is released
// while the thumb layer key is still held down) for quicker programming.
//
#ifndef THUMB_HOLDING_TYPE
#define THUMB_HOLDING_TYPE "balanced"
#endif

//
// THUMB_HOLDING_TIME defines how long you need to hold (milliseconds)
// a thumb key to activate a layer.  Shorter holds are treated as taps.
//
#ifndef THUMB_HOLDING_TIME
#define THUMB_HOLDING_TIME 200
#endif

//
// THUMB_REPEAT_DECAY defines how much time you have left (milliseconds)
// after tapping a key to hold it again in order to make it auto-repeat.
//
#ifndef THUMB_REPEAT_DECAY
#define THUMB_REPEAT_DECAY 300 // "tap then hold" for key auto-repeat
#endif

//
// SPACE_HOLDING_TYPE defines the flavor of ZMK hold-tap behavior to use
// for spacebar (assigned to the right thumb's home position by default).
//
// NOTE: The "balanced" flavor of ZMK hold-tap provides instant modifier
// activation for the symbol layer (if the tapped symbol key is released
// while the thumb layer key is still held down) for quicker programming.
//
#ifndef SPACE_HOLDING_TYPE
#define SPACE_HOLDING_TYPE THUMB_HOLDING_TYPE
#endif

//
// SPACE_HOLDING_TIME defines how long you need to hold (milliseconds)
// the space thumb key to activate.  Shorter holds are treated as taps.
//
#ifndef SPACE_HOLDING_TIME
#define SPACE_HOLDING_TIME THUMB_HOLDING_TIME
#endif

//
// SPACE_REPEAT_DECAY defines how much time you have left (milliseconds)
// after tapping a key to hold it again in order to make it auto-repeat.
//
#ifndef SPACE_REPEAT_DECAY
#define SPACE_REPEAT_DECAY 150
#endif

#define LEFT_HAND_KEYS      KEYS_L
#define RIGHT_HAND_KEYS     KEYS_R
#define THUMB_KEYS          THUMBS

#define LEFT_PINKY_KEY  A
#define LEFT_RING_KEY  R
#define LEFT_MIDDY_KEY  S
#define LEFT_INDEX_KEY  T
#define LEFT_PLAIN_KEY  D

#define RIGHT_PINKY_KEY O
#define RIGHT_RING_KEY I
#define RIGHT_MIDDY_KEY E
#define RIGHT_INDEX_KEY N
#define RIGHT_PLAIN_KEY H
#define LeftPlainKey  kp LEFT_PLAIN_KEY
#define RightPlainKey kp RIGHT_PLAIN_KEY

//
// Home row mods with bilateral combinations support
//
#ifndef PINKY_HOLDING_TYPE
#define PINKY_HOLDING_TYPE HOMEY_HOLDING_TYPE
#endif
#ifndef PINKY_CHORD_HOLDING_TYPE
#define PINKY_CHORD_HOLDING_TYPE CHORD_HOLDING_TYPE
#endif
#ifndef LEFT_PINKY_CHORD_HOLDING_TYPE
#define LEFT_PINKY_CHORD_HOLDING_TYPE PINKY_CHORD_HOLDING_TYPE
#endif
#ifndef RIGHT_PINKY_CHORD_HOLDING_TYPE
#define RIGHT_PINKY_CHORD_HOLDING_TYPE PINKY_CHORD_HOLDING_TYPE
#endif
#ifndef PINKY_HOLDING_TIME
#define PINKY_HOLDING_TIME HOMEY_HOLDING_TIME
#endif
#ifndef PINKY_CHORD_HOLDING_TIME
#define PINKY_CHORD_HOLDING_TIME CHORD_HOLDING_TIME
#endif
#ifndef LEFT_PINKY_CHORD_HOLDING_TIME
#define LEFT_PINKY_CHORD_HOLDING_TIME PINKY_CHORD_HOLDING_TIME
#endif
#ifndef RIGHT_PINKY_CHORD_HOLDING_TIME
#define RIGHT_PINKY_CHORD_HOLDING_TIME PINKY_CHORD_HOLDING_TIME
#endif
#ifndef PINKY_STREAK_DECAY
#define PINKY_STREAK_DECAY HOMEY_STREAK_DECAY
#endif
#ifndef PINKY_CHORD_STREAK_DECAY
#define PINKY_CHORD_STREAK_DECAY CHORD_STREAK_DECAY
#endif
#ifndef LEFT_PINKY_CHORD_STREAK_DECAY
#define LEFT_PINKY_CHORD_STREAK_DECAY PINKY_CHORD_STREAK_DECAY
#endif
#ifndef RIGHT_PINKY_CHORD_STREAK_DECAY
#define RIGHT_PINKY_CHORD_STREAK_DECAY PINKY_CHORD_STREAK_DECAY
#endif
#ifndef PINKY_REPEAT_DECAY
#define PINKY_REPEAT_DECAY HOMEY_REPEAT_DECAY
#endif
#ifndef PINKY_CHORD_REPEAT_DECAY
#define PINKY_CHORD_REPEAT_DECAY CHORD_REPEAT_DECAY
#endif
#ifndef LEFT_PINKY_CHORD_REPEAT_DECAY
#define LEFT_PINKY_CHORD_REPEAT_DECAY PINKY_CHORD_REPEAT_DECAY
#endif
#ifndef RIGHT_PINKY_CHORD_REPEAT_DECAY
#define RIGHT_PINKY_CHORD_REPEAT_DECAY PINKY_CHORD_REPEAT_DECAY
#endif
#ifndef RING_HOLDING_TYPE
#define RING_HOLDING_TYPE HOMEY_HOLDING_TYPE
#endif
#ifndef RING_CHORD_HOLDING_TYPE
#define RING_CHORD_HOLDING_TYPE CHORD_HOLDING_TYPE
#endif
#ifndef LEFT_RING_CHORD_HOLDING_TYPE
#define LEFT_RING_CHORD_HOLDING_TYPE RING_CHORD_HOLDING_TYPE
#endif
#ifndef RIGHT_RING_CHORD_HOLDING_TYPE
#define RIGHT_RING_CHORD_HOLDING_TYPE RING_CHORD_HOLDING_TYPE
#endif
#ifndef RING_HOLDING_TIME
#define RING_HOLDING_TIME HOMEY_HOLDING_TIME
#endif
#ifndef RING_CHORD_HOLDING_TIME
#define RING_CHORD_HOLDING_TIME CHORD_HOLDING_TIME
#endif
#ifndef LEFT_RING_CHORD_HOLDING_TIME
#define LEFT_RING_CHORD_HOLDING_TIME RING_CHORD_HOLDING_TIME
#endif
#ifndef RIGHT_RING_CHORD_HOLDING_TIME
#define RIGHT_RING_CHORD_HOLDING_TIME RING_CHORD_HOLDING_TIME
#endif
#ifndef RING_STREAK_DECAY
#define RING_STREAK_DECAY HOMEY_STREAK_DECAY
#endif
#ifndef RING_CHORD_STREAK_DECAY
#define RING_CHORD_STREAK_DECAY CHORD_STREAK_DECAY
#endif
#ifndef LEFT_RING_CHORD_STREAK_DECAY
#define LEFT_RING_CHORD_STREAK_DECAY RING_CHORD_STREAK_DECAY
#endif
#ifndef RIGHT_RING_CHORD_STREAK_DECAY
#define RIGHT_RING_CHORD_STREAK_DECAY RING_CHORD_STREAK_DECAY
#endif
#ifndef RING_REPEAT_DECAY
#define RING_REPEAT_DECAY HOMEY_REPEAT_DECAY
#endif
#ifndef RING_CHORD_REPEAT_DECAY
#define RING_CHORD_REPEAT_DECAY CHORD_REPEAT_DECAY
#endif
#ifndef LEFT_RING_CHORD_REPEAT_DECAY
#define LEFT_RING_CHORD_REPEAT_DECAY RING_CHORD_REPEAT_DECAY
#endif
#ifndef RIGHT_RING_CHORD_REPEAT_DECAY
#define RIGHT_RING_CHORD_REPEAT_DECAY RING_CHORD_REPEAT_DECAY
#endif
#ifndef MIDDY_HOLDING_TYPE
#define MIDDY_HOLDING_TYPE HOMEY_HOLDING_TYPE
#endif
#ifndef MIDDY_CHORD_HOLDING_TYPE
#define MIDDY_CHORD_HOLDING_TYPE CHORD_HOLDING_TYPE
#endif
#ifndef LEFT_MIDDY_CHORD_HOLDING_TYPE
#define LEFT_MIDDY_CHORD_HOLDING_TYPE MIDDY_CHORD_HOLDING_TYPE
#endif
#ifndef RIGHT_MIDDY_CHORD_HOLDING_TYPE
#define RIGHT_MIDDY_CHORD_HOLDING_TYPE MIDDY_CHORD_HOLDING_TYPE
#endif
#ifndef MIDDY_HOLDING_TIME
#define MIDDY_HOLDING_TIME HOMEY_HOLDING_TIME
#endif
#ifndef MIDDY_CHORD_HOLDING_TIME
#define MIDDY_CHORD_HOLDING_TIME CHORD_HOLDING_TIME
#endif
#ifndef LEFT_MIDDY_CHORD_HOLDING_TIME
#define LEFT_MIDDY_CHORD_HOLDING_TIME MIDDY_CHORD_HOLDING_TIME
#endif
#ifndef RIGHT_MIDDY_CHORD_HOLDING_TIME
#define RIGHT_MIDDY_CHORD_HOLDING_TIME MIDDY_CHORD_HOLDING_TIME
#endif
#ifndef MIDDY_STREAK_DECAY
#define MIDDY_STREAK_DECAY HOMEY_STREAK_DECAY
#endif
#ifndef MIDDY_CHORD_STREAK_DECAY
#define MIDDY_CHORD_STREAK_DECAY CHORD_STREAK_DECAY
#endif
#ifndef LEFT_MIDDY_CHORD_STREAK_DECAY
#define LEFT_MIDDY_CHORD_STREAK_DECAY MIDDY_CHORD_STREAK_DECAY
#endif
#ifndef RIGHT_MIDDY_CHORD_STREAK_DECAY
#define RIGHT_MIDDY_CHORD_STREAK_DECAY MIDDY_CHORD_STREAK_DECAY
#endif
#ifndef MIDDY_REPEAT_DECAY
#define MIDDY_REPEAT_DECAY HOMEY_REPEAT_DECAY
#endif
#ifndef MIDDY_CHORD_REPEAT_DECAY
#define MIDDY_CHORD_REPEAT_DECAY CHORD_REPEAT_DECAY
#endif
#ifndef LEFT_MIDDY_CHORD_REPEAT_DECAY
#define LEFT_MIDDY_CHORD_REPEAT_DECAY MIDDY_CHORD_REPEAT_DECAY
#endif
#ifndef RIGHT_MIDDY_CHORD_REPEAT_DECAY
#define RIGHT_MIDDY_CHORD_REPEAT_DECAY MIDDY_CHORD_REPEAT_DECAY
#endif
#ifndef INDEX_HOLDING_TYPE
#define INDEX_HOLDING_TYPE HOMEY_HOLDING_TYPE
#endif
#ifndef INDEX_CHORD_HOLDING_TYPE
#define INDEX_CHORD_HOLDING_TYPE CHORD_HOLDING_TYPE
#endif
#ifndef LEFT_INDEX_CHORD_HOLDING_TYPE
#define LEFT_INDEX_CHORD_HOLDING_TYPE INDEX_CHORD_HOLDING_TYPE
#endif
#ifndef RIGHT_INDEX_CHORD_HOLDING_TYPE
#define RIGHT_INDEX_CHORD_HOLDING_TYPE INDEX_CHORD_HOLDING_TYPE
#endif
#ifndef INDEX_HOLDING_TIME
#define INDEX_HOLDING_TIME HOMEY_HOLDING_TIME
#endif
#ifndef INDEX_CHORD_HOLDING_TIME
#define INDEX_CHORD_HOLDING_TIME CHORD_HOLDING_TIME
#endif
#ifndef LEFT_INDEX_CHORD_HOLDING_TIME
#define LEFT_INDEX_CHORD_HOLDING_TIME INDEX_CHORD_HOLDING_TIME
#endif
#ifndef RIGHT_INDEX_CHORD_HOLDING_TIME
#define RIGHT_INDEX_CHORD_HOLDING_TIME INDEX_CHORD_HOLDING_TIME
#endif
#ifndef INDEX_STREAK_DECAY
#define INDEX_STREAK_DECAY HOMEY_STREAK_DECAY
#endif
#ifndef INDEX_CHORD_STREAK_DECAY
#define INDEX_CHORD_STREAK_DECAY CHORD_STREAK_DECAY
#endif
#ifndef LEFT_INDEX_CHORD_STREAK_DECAY
#define LEFT_INDEX_CHORD_STREAK_DECAY INDEX_CHORD_STREAK_DECAY
#endif
#ifndef RIGHT_INDEX_CHORD_STREAK_DECAY
#define RIGHT_INDEX_CHORD_STREAK_DECAY INDEX_CHORD_STREAK_DECAY
#endif
#ifndef INDEX_REPEAT_DECAY
#define INDEX_REPEAT_DECAY HOMEY_REPEAT_DECAY
#endif
#ifndef INDEX_CHORD_REPEAT_DECAY
#define INDEX_CHORD_REPEAT_DECAY CHORD_REPEAT_DECAY
#endif
#ifndef LEFT_INDEX_CHORD_REPEAT_DECAY
#define LEFT_INDEX_CHORD_REPEAT_DECAY INDEX_CHORD_REPEAT_DECAY
#endif
#ifndef RIGHT_INDEX_CHORD_REPEAT_DECAY
#define RIGHT_INDEX_CHORD_REPEAT_DECAY INDEX_CHORD_REPEAT_DECAY
#endif
#ifndef LEFT_PINKY_HOLDING_TYPE
#define LEFT_PINKY_HOLDING_TYPE PINKY_HOLDING_TYPE
#endif
#ifndef LEFT_PINKY_HOLDING_TIME
#define LEFT_PINKY_HOLDING_TIME PINKY_HOLDING_TIME
#endif
#ifndef LEFT_PINKY_STREAK_DECAY
#define LEFT_PINKY_STREAK_DECAY PINKY_STREAK_DECAY
#endif
#ifndef LEFT_PINKY_REPEAT_DECAY
#define LEFT_PINKY_REPEAT_DECAY PINKY_REPEAT_DECAY
#endif

#include "../zmk-nodefree-config/helper.h"

ZMK_BEHAVIOR(left_pinky, hold_tap, 
    flavor = LEFT_PINKY_HOLDING_TYPE;
    hold-trigger-key-positions = <RIGHT_HAND_KEYS THUMB_KEYS>;
    hold-trigger-on-release; // wait for other home row mods
    tapping-term-ms = <LEFT_PINKY_HOLDING_TIME>;
    quick-tap-ms = <LEFT_PINKY_REPEAT_DECAY>;
    require-prior-idle-ms = <LEFT_PINKY_STREAK_DECAY>;
    bindings = <&kp>, <&kp>;
)
#ifdef ENFORCE_BILATERAL
ZMK_BEHAVIOR(left_pinky_bilateral, hold_tap, 
    flavor = LEFT_PINKY_HOLDING_TYPE;
    hold-trigger-key-positions = <RIGHT_HAND_KEYS THUMB_KEYS>;
    hold-trigger-on-release; // wait for other home row mods
    tapping-term-ms = <LEFT_PINKY_HOLDING_TIME>;
    quick-tap-ms = <LEFT_PINKY_REPEAT_DECAY>;
    require-prior-idle-ms = <LEFT_PINKY_STREAK_DECAY>;
    bindings = <&left_pinky_hold>, <&kp>;
)
#endif
#ifdef ENFORCE_BILATERAL
ZMK_BEHAVIOR(left_pinky_hold, macro_one_param,
    wait-ms = <0>;
    tap-ms = <0>;
    bindings
        = <&macro_param_1to1>
        , <&macro_press &kp MACRO_PLACEHOLDER
                        &mo LAYER_LeftPinky>
        , <&macro_pause_for_release>
        , <&macro_param_1to1>
        , <&macro_release &kp MACRO_PLACEHOLDER
                          &mo LAYER_LeftPinky>
        ;
)
ZMK_BEHAVIOR(left_pinky_tap, macro_one_param,
    wait-ms = <0>;
    tap-ms = <0>;
    bindings
        = <&macro_release
            &kp LSFT &kp RSFT
            &kp LALT &kp RALT
            &kp LCTL &kp RCTL
            &kp LGUI &kp RGUI>
        , <&macro_tap &kp LEFT_PINKY_KEY>
        , <&macro_param_1to1>
        , <&macro_tap &kp MACRO_PLACEHOLDER>
        ;
)
#endif
#define LeftPinky(key, layer_index) LeftPinky_unroll(layer_index) (key)
#define LeftPinky_unroll(layer_index) LeftPinky_concat(LeftPinky_layer, layer_index)
#define LeftPinky_concat(prefix, layer_index) prefix ## layer_index
#ifdef ENFORCE_BILATERAL
#define left_pinky_layer0_variant left_pinky_bilateral
#else
#define left_pinky_layer0_variant left_pinky
#endif
#define LeftPinky_layer0(key) left_pinky_layer0_variant LEFT_PINKY_MOD key
#define LeftPinky_layer1(key) left_pinky LEFT_PINKY_MOD key
#define LeftPinky_layer2(key) left_pinky LEFT_PINKY_MOD key
#define LeftPinky_layer3(key) left_pinky LEFT_PINKY_MOD key
#define LeftPinky_layer4(key) left_pinky LEFT_PINKY_MOD key
#define LeftPinky_layer5(key) left_pinky LEFT_PINKY_MOD key
#define LeftPinky_layer6(key) left_pinky LEFT_PINKY_MOD key
#define LeftPinky_layer7(key) left_pinky LEFT_PINKY_MOD key
#define LeftPinky_layer8(key) left_pinky LEFT_PINKY_MOD key
#ifndef RIGHT_PINKY_HOLDING_TYPE
#define RIGHT_PINKY_HOLDING_TYPE PINKY_HOLDING_TYPE
#endif
#ifndef RIGHT_PINKY_HOLDING_TIME
#define RIGHT_PINKY_HOLDING_TIME PINKY_HOLDING_TIME
#endif
#ifndef RIGHT_PINKY_STREAK_DECAY
#define RIGHT_PINKY_STREAK_DECAY PINKY_STREAK_DECAY
#endif
#ifndef RIGHT_PINKY_REPEAT_DECAY
#define RIGHT_PINKY_REPEAT_DECAY PINKY_REPEAT_DECAY
#endif

ZMK_BEHAVIOR(right_pinky, hold_tap, 
    flavor = RIGHT_PINKY_HOLDING_TYPE;
    hold-trigger-key-positions = <LEFT_HAND_KEYS THUMB_KEYS>;
    hold-trigger-on-release; // wait for other home row mods
    tapping-term-ms = <RIGHT_PINKY_HOLDING_TIME>;
    quick-tap-ms = <RIGHT_PINKY_REPEAT_DECAY>;
    require-prior-idle-ms = <RIGHT_PINKY_STREAK_DECAY>;
    bindings = <&kp>, <&kp>;
)
#ifdef ENFORCE_BILATERAL
ZMK_BEHAVIOR(right_pinky_bilateral, hold_tap, 
    flavor = RIGHT_PINKY_HOLDING_TYPE;
    hold-trigger-key-positions = <LEFT_HAND_KEYS THUMB_KEYS>;
    hold-trigger-on-release; // wait for other home row mods
    tapping-term-ms = <RIGHT_PINKY_HOLDING_TIME>;
    quick-tap-ms = <RIGHT_PINKY_REPEAT_DECAY>;
    require-prior-idle-ms = <RIGHT_PINKY_STREAK_DECAY>;
    bindings = <&right_pinky_hold>, <&kp>;
)
#endif
#ifdef ENFORCE_BILATERAL
ZMK_BEHAVIOR(right_pinky_hold, macro_one_param,
    wait-ms = <0>;
    tap-ms = <0>;
    bindings
        = <&macro_param_1to1>
        , <&macro_press &kp MACRO_PLACEHOLDER
                        &mo LAYER_RightPinky>
        , <&macro_pause_for_release>
        , <&macro_param_1to1>
        , <&macro_release &kp MACRO_PLACEHOLDER
                          &mo LAYER_RightPinky>
        ;
)
ZMK_BEHAVIOR(right_pinky_tap, macro_one_param,
    wait-ms = <0>;
    tap-ms = <0>;
    bindings
        = <&macro_release
            &kp LSFT &kp RSFT
            &kp LALT &kp RALT
            &kp LCTL &kp RCTL
            &kp LGUI &kp RGUI>
        , <&macro_tap &kp RIGHT_PINKY_KEY>
        , <&macro_param_1to1>
        , <&macro_tap &kp MACRO_PLACEHOLDER>
        ;
)
#endif
#define RightPinky(key, layer_index) RightPinky_unroll(layer_index) (key)
#define RightPinky_unroll(layer_index) RightPinky_concat(RightPinky_layer, layer_index)
#define RightPinky_concat(prefix, layer_index) prefix ## layer_index
#ifdef ENFORCE_BILATERAL
#define right_pinky_layer0_variant right_pinky_bilateral
#else
#define right_pinky_layer0_variant right_pinky
#endif
#define RightPinky_layer0(key) right_pinky_layer0_variant RIGHT_PINKY_MOD key
#define RightPinky_layer1(key) right_pinky RIGHT_PINKY_MOD key
#define RightPinky_layer2(key) right_pinky RIGHT_PINKY_MOD key
#define RightPinky_layer3(key) right_pinky RIGHT_PINKY_MOD key
#define RightPinky_layer4(key) right_pinky RIGHT_PINKY_MOD key
#define RightPinky_layer5(key) right_pinky RIGHT_PINKY_MOD key
#define RightPinky_layer6(key) right_pinky RIGHT_PINKY_MOD key
#define RightPinky_layer7(key) right_pinky RIGHT_PINKY_MOD key
#define RightPinky_layer8(key) right_pinky RIGHT_PINKY_MOD key
#ifndef LEFT_RING_HOLDING_TYPE
#define LEFT_RING_HOLDING_TYPE RING_HOLDING_TYPE
#endif
#ifndef LEFT_RING_HOLDING_TIME
#define LEFT_RING_HOLDING_TIME RING_HOLDING_TIME
#endif
#ifndef LEFT_RING_STREAK_DECAY
#define LEFT_RING_STREAK_DECAY RING_STREAK_DECAY
#endif
#ifndef LEFT_RING_REPEAT_DECAY
#define LEFT_RING_REPEAT_DECAY RING_REPEAT_DECAY
#endif

ZMK_BEHAVIOR(left_ring, hold_tap, 
    flavor = LEFT_RING_HOLDING_TYPE;
    hold-trigger-key-positions = <RIGHT_HAND_KEYS THUMB_KEYS>;
    hold-trigger-on-release; // wait for other home row mods
    tapping-term-ms = <LEFT_RING_HOLDING_TIME>;
    quick-tap-ms = <LEFT_RING_REPEAT_DECAY>;
    require-prior-idle-ms = <LEFT_RING_STREAK_DECAY>;
    bindings = <&kp>, <&kp>;
)
#ifdef ENFORCE_BILATERAL
ZMK_BEHAVIOR(left_ring_bilateral, hold_tap, 
    flavor = LEFT_RING_HOLDING_TYPE;
    hold-trigger-key-positions = <RIGHT_HAND_KEYS THUMB_KEYS>;
    hold-trigger-on-release; // wait for other home row mods
    tapping-term-ms = <LEFT_RING_HOLDING_TIME>;
    quick-tap-ms = <LEFT_RING_REPEAT_DECAY>;
    require-prior-idle-ms = <LEFT_RING_STREAK_DECAY>;
    bindings = <&left_ring_hold>, <&kp>;
)
#endif
#ifdef ENFORCE_BILATERAL
ZMK_BEHAVIOR(left_ring_hold, macro_one_param,
    wait-ms = <0>;
    tap-ms = <0>;
    bindings
        = <&macro_param_1to1>
        , <&macro_press &kp MACRO_PLACEHOLDER
                        &mo LAYER_LeftRing>
        , <&macro_pause_for_release>
        , <&macro_param_1to1>
        , <&macro_release &kp MACRO_PLACEHOLDER
                          &mo LAYER_LeftRing>
        ;
)
ZMK_BEHAVIOR(left_ring_tap, macro_one_param,
    wait-ms = <0>;
    tap-ms = <0>;
    bindings
        = <&macro_release
            &kp LSFT &kp RSFT
            &kp LALT &kp RALT
            &kp LCTL &kp RCTL
            &kp LGUI &kp RGUI>
        , <&macro_tap &kp LEFT_RING_KEY>
        , <&macro_param_1to1>
        , <&macro_tap &kp MACRO_PLACEHOLDER>
        ;
)
#endif
#define LeftRing(key, layer_index) LeftRing_unroll(layer_index) (key)
#define LeftRing_unroll(layer_index) LeftRing_concat(LeftRing_layer, layer_index)
#define LeftRing_concat(prefix, layer_index) prefix ## layer_index
#ifdef ENFORCE_BILATERAL
#define left_ring_layer0_variant left_ring_bilateral
#else
#define left_ring_layer0_variant left_ring
#endif
#define LeftRing_layer0(key) left_ring_layer0_variant LEFT_RING_MOD key
#define LeftRing_layer1(key) left_ring LEFT_RING_MOD key
#define LeftRing_layer2(key) left_ring LEFT_RING_MOD key
#define LeftRing_layer3(key) left_ring LEFT_RING_MOD key
#define LeftRing_layer4(key) left_ring LEFT_RING_MOD key
#define LeftRing_layer5(key) left_ring LEFT_RING_MOD key
#define LeftRing_layer6(key) left_ring LEFT_RING_MOD key
#define LeftRing_layer7(key) left_ring LEFT_RING_MOD key
#define LeftRing_layer8(key) left_ring LEFT_RING_MOD key
#ifndef RIGHT_RING_HOLDING_TYPE
#define RIGHT_RING_HOLDING_TYPE RING_HOLDING_TYPE
#endif
#ifndef RIGHT_RING_HOLDING_TIME
#define RIGHT_RING_HOLDING_TIME RING_HOLDING_TIME
#endif
#ifndef RIGHT_RING_STREAK_DECAY
#define RIGHT_RING_STREAK_DECAY RING_STREAK_DECAY
#endif
#ifndef RIGHT_RING_REPEAT_DECAY
#define RIGHT_RING_REPEAT_DECAY RING_REPEAT_DECAY
#endif

ZMK_BEHAVIOR(right_ring, hold_tap, 
    flavor = RIGHT_RING_HOLDING_TYPE;
    hold-trigger-key-positions = <LEFT_HAND_KEYS THUMB_KEYS>;
    hold-trigger-on-release; // wait for other home row mods
    tapping-term-ms = <RIGHT_RING_HOLDING_TIME>;
    quick-tap-ms = <RIGHT_RING_REPEAT_DECAY>;
    require-prior-idle-ms = <RIGHT_RING_STREAK_DECAY>;
    bindings = <&kp>, <&kp>;
)
#ifdef ENFORCE_BILATERAL
ZMK_BEHAVIOR(right_ring_bilateral, hold_tap, 
    flavor = RIGHT_RING_HOLDING_TYPE;
    hold-trigger-key-positions = <LEFT_HAND_KEYS THUMB_KEYS>;
    hold-trigger-on-release; // wait for other home row mods
    tapping-term-ms = <RIGHT_RING_HOLDING_TIME>;
    quick-tap-ms = <RIGHT_RING_REPEAT_DECAY>;
    require-prior-idle-ms = <RIGHT_RING_STREAK_DECAY>;
    bindings = <&right_ring_hold>, <&kp>;
)
#endif
#ifdef ENFORCE_BILATERAL
ZMK_BEHAVIOR(right_ring_hold, macro_one_param,
    wait-ms = <0>;
    tap-ms = <0>;
    bindings
        = <&macro_param_1to1>
        , <&macro_press &kp MACRO_PLACEHOLDER
                        &mo LAYER_RightRing>
        , <&macro_pause_for_release>
        , <&macro_param_1to1>
        , <&macro_release &kp MACRO_PLACEHOLDER
                          &mo LAYER_RightRing>
        ;
)
ZMK_BEHAVIOR(right_ring_tap, macro_one_param,
    wait-ms = <0>;
    tap-ms = <0>;
    bindings
        = <&macro_release
            &kp LSFT &kp RSFT
            &kp LALT &kp RALT
            &kp LCTL &kp RCTL
            &kp LGUI &kp RGUI>
        , <&macro_tap &kp RIGHT_RING_KEY>
        , <&macro_param_1to1>
        , <&macro_tap &kp MACRO_PLACEHOLDER>
        ;
)
#endif
#define RightRing(key, layer_index) RightRing_unroll(layer_index) (key)
#define RightRing_unroll(layer_index) RightRing_concat(RightRing_layer, layer_index)
#define RightRing_concat(prefix, layer_index) prefix ## layer_index
#ifdef ENFORCE_BILATERAL
#define right_ring_layer0_variant right_ring_bilateral
#else
#define right_ring_layer0_variant right_ring
#endif
#define RightRing_layer0(key) right_ring_layer0_variant RIGHT_RING_MOD key
#define RightRing_layer1(key) right_ring RIGHT_RING_MOD key
#define RightRing_layer2(key) right_ring RIGHT_RING_MOD key
#define RightRing_layer3(key) right_ring RIGHT_RING_MOD key
#define RightRing_layer4(key) right_ring RIGHT_RING_MOD key
#define RightRing_layer5(key) right_ring RIGHT_RING_MOD key
#define RightRing_layer6(key) right_ring RIGHT_RING_MOD key
#define RightRing_layer7(key) right_ring RIGHT_RING_MOD key
#define RightRing_layer8(key) right_ring RIGHT_RING_MOD key

#ifndef LEFT_MIDDY_HOLDING_TYPE
#define LEFT_MIDDY_HOLDING_TYPE MIDDY_HOLDING_TYPE
#endif
#ifndef LEFT_MIDDY_HOLDING_TIME
#define LEFT_MIDDY_HOLDING_TIME MIDDY_HOLDING_TIME
#endif
#ifndef LEFT_MIDDY_STREAK_DECAY
#define LEFT_MIDDY_STREAK_DECAY MIDDY_STREAK_DECAY
#endif
#ifndef LEFT_MIDDY_REPEAT_DECAY
#define LEFT_MIDDY_REPEAT_DECAY MIDDY_REPEAT_DECAY
#endif

ZMK_BEHAVIOR(left_middy, hold_tap, 
    flavor = LEFT_MIDDY_HOLDING_TYPE;
    hold-trigger-key-positions = <RIGHT_HAND_KEYS THUMB_KEYS>;
    hold-trigger-on-release; // wait for other home row mods
    tapping-term-ms = <LEFT_MIDDY_HOLDING_TIME>;
    quick-tap-ms = <LEFT_MIDDY_REPEAT_DECAY>;
    require-prior-idle-ms = <LEFT_MIDDY_STREAK_DECAY>;
    bindings = <&kp>, <&kp>;
)
#ifdef ENFORCE_BILATERAL
ZMK_BEHAVIOR(left_middy_bilateral, hold_tap, 
    flavor = LEFT_MIDDY_HOLDING_TYPE;
    hold-trigger-key-positions = <RIGHT_HAND_KEYS THUMB_KEYS>;
    hold-trigger-on-release; // wait for other home row mods
    tapping-term-ms = <LEFT_MIDDY_HOLDING_TIME>;
    quick-tap-ms = <LEFT_MIDDY_REPEAT_DECAY>;
    require-prior-idle-ms = <LEFT_MIDDY_STREAK_DECAY>;
    bindings = <&left_middy_hold>, <&kp>;
)
#endif
#ifdef ENFORCE_BILATERAL
ZMK_BEHAVIOR(left_middy_hold, macro_one_param,
    wait-ms = <0>;
    tap-ms = <0>;
    bindings
        = <&macro_param_1to1>
        , <&macro_press &kp MACRO_PLACEHOLDER
                        &mo LAYER_LeftMiddy>
        , <&macro_pause_for_release>
        , <&macro_param_1to1>
        , <&macro_release &kp MACRO_PLACEHOLDER
                          &mo LAYER_LeftMiddy>
        ;
)
ZMK_BEHAVIOR(left_middy_tap, macro_one_param,
    wait-ms = <0>;
    tap-ms = <0>;
    bindings
        = <&macro_release
            &kp LSFT &kp RSFT
            &kp LALT &kp RALT
            &kp LCTL &kp RCTL
            &kp LGUI &kp RGUI>
        , <&macro_tap &kp LEFT_MIDDY_KEY>
        , <&macro_param_1to1>
        , <&macro_tap &kp MACRO_PLACEHOLDER>
        ;
)
#endif
#define LeftMiddy(key, layer_index) LeftMiddy_unroll(layer_index) (key)
#define LeftMiddy_unroll(layer_index) LeftMiddy_concat(LeftMiddy_layer, layer_index)
#define LeftMiddy_concat(prefix, layer_index) prefix ## layer_index
#ifdef ENFORCE_BILATERAL
#define left_middy_layer0_variant left_middy_bilateral
#else
#define left_middy_layer0_variant left_middy
#endif
#define LeftMiddy_layer0(key) left_middy_layer0_variant LEFT_MIDDY_MOD key
#define LeftMiddy_layer1(key) left_middy LEFT_MIDDY_MOD key
#define LeftMiddy_layer2(key) left_middy LEFT_MIDDY_MOD key
#define LeftMiddy_layer3(key) left_middy LEFT_MIDDY_MOD key
#define LeftMiddy_layer4(key) left_middy LEFT_MIDDY_MOD key
#define LeftMiddy_layer5(key) left_middy LEFT_MIDDY_MOD key
#define LeftMiddy_layer6(key) left_middy LEFT_MIDDY_MOD key
#define LeftMiddy_layer7(key) left_middy LEFT_MIDDY_MOD key
#define LeftMiddy_layer8(key) left_middy LEFT_MIDDY_MOD key
#ifndef RIGHT_MIDDY_HOLDING_TYPE
#define RIGHT_MIDDY_HOLDING_TYPE MIDDY_HOLDING_TYPE
#endif
#ifndef RIGHT_MIDDY_HOLDING_TIME
#define RIGHT_MIDDY_HOLDING_TIME MIDDY_HOLDING_TIME
#endif
#ifndef RIGHT_MIDDY_STREAK_DECAY
#define RIGHT_MIDDY_STREAK_DECAY MIDDY_STREAK_DECAY
#endif
#ifndef RIGHT_MIDDY_REPEAT_DECAY
#define RIGHT_MIDDY_REPEAT_DECAY MIDDY_REPEAT_DECAY
#endif

ZMK_BEHAVIOR(right_middy, hold_tap, 
    flavor = RIGHT_MIDDY_HOLDING_TYPE;
    hold-trigger-key-positions = <LEFT_HAND_KEYS THUMB_KEYS>;
    hold-trigger-on-release; // wait for other home row mods
    tapping-term-ms = <RIGHT_MIDDY_HOLDING_TIME>;
    quick-tap-ms = <RIGHT_MIDDY_REPEAT_DECAY>;
    require-prior-idle-ms = <RIGHT_MIDDY_STREAK_DECAY>;
    bindings = <&kp>, <&kp>;
)
#ifdef ENFORCE_BILATERAL
ZMK_BEHAVIOR(right_middy_bilateral, hold_tap, 
    flavor = RIGHT_MIDDY_HOLDING_TYPE;
    hold-trigger-key-positions = <LEFT_HAND_KEYS THUMB_KEYS>;
    hold-trigger-on-release; // wait for other home row mods
    tapping-term-ms = <RIGHT_MIDDY_HOLDING_TIME>;
    quick-tap-ms = <RIGHT_MIDDY_REPEAT_DECAY>;
    require-prior-idle-ms = <RIGHT_MIDDY_STREAK_DECAY>;
    bindings = <&right_middy_hold>, <&kp>;
)
#endif
#ifdef ENFORCE_BILATERAL
ZMK_BEHAVIOR(right_middy_hold, macro_one_param,
    wait-ms = <0>;
    tap-ms = <0>;
    bindings
        = <&macro_param_1to1>
        , <&macro_press &kp MACRO_PLACEHOLDER
                        &mo LAYER_RightMiddy>
        , <&macro_pause_for_release>
        , <&macro_param_1to1>
        , <&macro_release &kp MACRO_PLACEHOLDER
                          &mo LAYER_RightMiddy>
        ;
)
ZMK_BEHAVIOR(right_middy_tap, macro_one_param,
    wait-ms = <0>;
    tap-ms = <0>;
    bindings
        = <&macro_release
            &kp LSFT &kp RSFT
            &kp LALT &kp RALT
            &kp LCTL &kp RCTL
            &kp LGUI &kp RGUI>
        , <&macro_tap &kp RIGHT_MIDDY_KEY>
        , <&macro_param_1to1>
        , <&macro_tap &kp MACRO_PLACEHOLDER>
        ;
)
#endif
#define RightMiddy(key, layer_index) RightMiddy_unroll(layer_index) (key)
#define RightMiddy_unroll(layer_index) RightMiddy_concat(RightMiddy_layer, layer_index)
#define RightMiddy_concat(prefix, layer_index) prefix ## layer_index
#ifdef ENFORCE_BILATERAL
#define right_middy_layer0_variant right_middy_bilateral
#else
#define right_middy_layer0_variant right_middy
#endif
#define RightMiddy_layer0(key) right_middy_layer0_variant RIGHT_MIDDY_MOD key
#define RightMiddy_layer1(key) right_middy RIGHT_MIDDY_MOD key
#define RightMiddy_layer2(key) right_middy RIGHT_MIDDY_MOD key
#define RightMiddy_layer3(key) right_middy RIGHT_MIDDY_MOD key
#define RightMiddy_layer4(key) right_middy RIGHT_MIDDY_MOD key
#define RightMiddy_layer5(key) right_middy RIGHT_MIDDY_MOD key
#define RightMiddy_layer6(key) right_middy RIGHT_MIDDY_MOD key
#define RightMiddy_layer7(key) right_middy RIGHT_MIDDY_MOD key
#define RightMiddy_layer8(key) right_middy RIGHT_MIDDY_MOD key
#ifndef LEFT_INDEX_HOLDING_TYPE
#define LEFT_INDEX_HOLDING_TYPE INDEX_HOLDING_TYPE
#endif
#ifndef LEFT_INDEX_HOLDING_TIME
#define LEFT_INDEX_HOLDING_TIME INDEX_HOLDING_TIME
#endif
#ifndef LEFT_INDEX_STREAK_DECAY
#define LEFT_INDEX_STREAK_DECAY INDEX_STREAK_DECAY
#endif
#ifndef LEFT_INDEX_REPEAT_DECAY
#define LEFT_INDEX_REPEAT_DECAY INDEX_REPEAT_DECAY
#endif

ZMK_BEHAVIOR(left_index, hold_tap, 
    flavor = LEFT_INDEX_HOLDING_TYPE;
    hold-trigger-key-positions = <RIGHT_HAND_KEYS THUMB_KEYS>;
    hold-trigger-on-release; // wait for other home row mods
    tapping-term-ms = <LEFT_INDEX_HOLDING_TIME>;
    quick-tap-ms = <LEFT_INDEX_REPEAT_DECAY>;
    require-prior-idle-ms = <LEFT_INDEX_STREAK_DECAY>;
    bindings = <&kp>, <&kp>;
)
#ifdef ENFORCE_BILATERAL
ZMK_BEHAVIOR(left_index_bilateral, hold_tap, 
    flavor = LEFT_INDEX_HOLDING_TYPE;
    hold-trigger-key-positions = <RIGHT_HAND_KEYS THUMB_KEYS>;
    hold-trigger-on-release; // wait for other home row mods
    tapping-term-ms = <LEFT_INDEX_HOLDING_TIME>;
    quick-tap-ms = <LEFT_INDEX_REPEAT_DECAY>;
    require-prior-idle-ms = <LEFT_INDEX_STREAK_DECAY>;
    bindings = <&left_index_hold>, <&kp>;
)
#endif
#ifdef ENFORCE_BILATERAL
ZMK_BEHAVIOR(left_index_hold, macro_one_param,
    wait-ms = <0>;
    tap-ms = <0>;
    bindings
        = <&macro_param_1to1>
        , <&macro_press &kp MACRO_PLACEHOLDER
                        &mo LAYER_LeftIndex>
        , <&macro_pause_for_release>
        , <&macro_param_1to1>
        , <&macro_release &kp MACRO_PLACEHOLDER
                          &mo LAYER_LeftIndex>
        ;
)
ZMK_BEHAVIOR(left_index_tap, macro_one_param,
    wait-ms = <0>;
    tap-ms = <0>;
    bindings
        = <&macro_release
            &kp LSFT &kp RSFT
            &kp LALT &kp RALT
            &kp LCTL &kp RCTL
            &kp LGUI &kp RGUI>
        , <&macro_tap &kp LEFT_INDEX_KEY>
        , <&macro_param_1to1>
        , <&macro_tap &kp MACRO_PLACEHOLDER>
        ;
)
#endif
#define LeftIndex(key, layer_index) LeftIndex_unroll(layer_index) (key)
#define LeftIndex_unroll(layer_index) LeftIndex_concat(LeftIndex_layer, layer_index)
#define LeftIndex_concat(prefix, layer_index) prefix ## layer_index
#ifdef ENFORCE_BILATERAL
#define left_index_layer0_variant left_index_bilateral
#else
#define left_index_layer0_variant left_index
#endif
#define LeftIndex_layer0(key) left_index_layer0_variant LEFT_INDEX_MOD key
#define LeftIndex_layer1(key) left_index LEFT_INDEX_MOD key
#define LeftIndex_layer2(key) left_index LEFT_INDEX_MOD key
#define LeftIndex_layer3(key) left_index LEFT_INDEX_MOD key
#define LeftIndex_layer4(key) left_index LEFT_INDEX_MOD key
#define LeftIndex_layer5(key) left_index LEFT_INDEX_MOD key
#define LeftIndex_layer6(key) left_index LEFT_INDEX_MOD key
#define LeftIndex_layer7(key) left_index LEFT_INDEX_MOD key
#define LeftIndex_layer8(key) left_index LEFT_INDEX_MOD key
#ifndef RIGHT_INDEX_HOLDING_TYPE
#define RIGHT_INDEX_HOLDING_TYPE INDEX_HOLDING_TYPE
#endif
#ifndef RIGHT_INDEX_HOLDING_TIME
#define RIGHT_INDEX_HOLDING_TIME INDEX_HOLDING_TIME
#endif
#ifndef RIGHT_INDEX_STREAK_DECAY
#define RIGHT_INDEX_STREAK_DECAY INDEX_STREAK_DECAY
#endif
#ifndef RIGHT_INDEX_REPEAT_DECAY
#define RIGHT_INDEX_REPEAT_DECAY INDEX_REPEAT_DECAY
#endif

ZMK_BEHAVIOR(right_index, hold_tap, 
    flavor = RIGHT_INDEX_HOLDING_TYPE;
    hold-trigger-key-positions = <LEFT_HAND_KEYS THUMB_KEYS>;
    hold-trigger-on-release; // wait for other home row mods
    tapping-term-ms = <RIGHT_INDEX_HOLDING_TIME>;
    quick-tap-ms = <RIGHT_INDEX_REPEAT_DECAY>;
    require-prior-idle-ms = <RIGHT_INDEX_STREAK_DECAY>;
    bindings = <&kp>, <&kp>;
)
#ifdef ENFORCE_BILATERAL
ZMK_BEHAVIOR(right_index_bilateral, hold_tap, 
    flavor = RIGHT_INDEX_HOLDING_TYPE;
    hold-trigger-key-positions = <LEFT_HAND_KEYS THUMB_KEYS>;
    hold-trigger-on-release; // wait for other home row mods
    tapping-term-ms = <RIGHT_INDEX_HOLDING_TIME>;
    quick-tap-ms = <RIGHT_INDEX_REPEAT_DECAY>;
    require-prior-idle-ms = <RIGHT_INDEX_STREAK_DECAY>;
    bindings = <&right_index_hold>, <&kp>;
)
#endif
#ifdef ENFORCE_BILATERAL
ZMK_BEHAVIOR(right_index_hold, macro_one_param,
    wait-ms = <0>;
    tap-ms = <0>;
    bindings
        = <&macro_param_1to1>
        , <&macro_press &kp MACRO_PLACEHOLDER
                        &mo LAYER_RightIndex>
        , <&macro_pause_for_release>
        , <&macro_param_1to1>
        , <&macro_release &kp MACRO_PLACEHOLDER
                          &mo LAYER_RightIndex>
        ;
)
ZMK_BEHAVIOR(right_index_tap, macro_one_param,
    wait-ms = <0>;
    tap-ms = <0>;
    bindings
        = <&macro_release
            &kp LSFT &kp RSFT
            &kp LALT &kp RALT
            &kp LCTL &kp RCTL
            &kp LGUI &kp RGUI>
        , <&macro_tap &kp RIGHT_INDEX_KEY>
        , <&macro_param_1to1>
        , <&macro_tap &kp MACRO_PLACEHOLDER>
        ;
)
#endif
#define RightIndex(key, layer_index) RightIndex_unroll(layer_index) (key)
#define RightIndex_unroll(layer_index) RightIndex_concat(RightIndex_layer, layer_index)
#define RightIndex_concat(prefix, layer_index) prefix ## layer_index
#ifdef ENFORCE_BILATERAL
#define right_index_layer0_variant right_index_bilateral
#else
#define right_index_layer0_variant right_index
#endif
#define RightIndex_layer0(key) right_index_layer0_variant RIGHT_INDEX_MOD key
#define RightIndex_layer1(key) right_index RIGHT_INDEX_MOD key
#define RightIndex_layer2(key) right_index RIGHT_INDEX_MOD key
#define RightIndex_layer3(key) right_index RIGHT_INDEX_MOD key
#define RightIndex_layer4(key) right_index RIGHT_INDEX_MOD key
#define RightIndex_layer5(key) right_index RIGHT_INDEX_MOD key
#define RightIndex_layer6(key) right_index RIGHT_INDEX_MOD key
#define RightIndex_layer7(key) right_index RIGHT_INDEX_MOD key
#define RightIndex_layer8(key) right_index RIGHT_INDEX_MOD key
#ifndef LEFT_RING_PINKY_HOLDING_TYPE
#define LEFT_RING_PINKY_HOLDING_TYPE LEFT_RING_CHORD_HOLDING_TYPE
#endif
#ifndef LEFT_RING_PINKY_HOLDING_TIME
#define LEFT_RING_PINKY_HOLDING_TIME LEFT_RING_CHORD_HOLDING_TIME
#endif
#ifndef LEFT_RING_PINKY_STREAK_DECAY
#define LEFT_RING_PINKY_STREAK_DECAY LEFT_RING_CHORD_STREAK_DECAY
#endif
#ifndef LEFT_RING_PINKY_REPEAT_DECAY
#define LEFT_RING_PINKY_REPEAT_DECAY LEFT_RING_CHORD_REPEAT_DECAY
#endif

ZMK_BEHAVIOR(left_ring_pinky, hold_tap, 
    flavor = LEFT_RING_HOLDING_TYPE;
    hold-trigger-key-positions = <RIGHT_HAND_KEYS THUMB_KEYS>;
    hold-trigger-on-release; // wait for other home row mods
    tapping-term-ms = <LEFT_RING_HOLDING_TIME>;
    quick-tap-ms = <LEFT_RING_REPEAT_DECAY>;
    require-prior-idle-ms = <LEFT_RING_STREAK_DECAY>;
    bindings = <&kp>, <&kp>;
)
#ifdef ENFORCE_BILATERAL
ZMK_BEHAVIOR(left_ring_pinky_bilateral, hold_tap, 
    flavor = LEFT_RING_HOLDING_TYPE;
    hold-trigger-key-positions = <RIGHT_HAND_KEYS THUMB_KEYS>;
    hold-trigger-on-release; // wait for other home row mods
    tapping-term-ms = <LEFT_RING_HOLDING_TIME>;
    quick-tap-ms = <LEFT_RING_REPEAT_DECAY>;
    require-prior-idle-ms = <LEFT_RING_STREAK_DECAY>;
    bindings = <&kp>, <&left_ring_tap>;
)
#endif
#define LeftRingPinky left_ring_pinky_bilateral LEFT_PINKY_MOD LEFT_PINKY_KEY
#ifndef LEFT_MIDDY_PINKY_HOLDING_TYPE
#define LEFT_MIDDY_PINKY_HOLDING_TYPE LEFT_MIDDY_CHORD_HOLDING_TYPE
#endif
#ifndef LEFT_MIDDY_PINKY_HOLDING_TIME
#define LEFT_MIDDY_PINKY_HOLDING_TIME LEFT_MIDDY_CHORD_HOLDING_TIME
#endif
#ifndef LEFT_MIDDY_PINKY_STREAK_DECAY
#define LEFT_MIDDY_PINKY_STREAK_DECAY LEFT_MIDDY_CHORD_STREAK_DECAY
#endif
#ifndef LEFT_MIDDY_PINKY_REPEAT_DECAY
#define LEFT_MIDDY_PINKY_REPEAT_DECAY LEFT_MIDDY_CHORD_REPEAT_DECAY
#endif

ZMK_BEHAVIOR(left_middy_pinky, hold_tap, 
    flavor = LEFT_MIDDY_HOLDING_TYPE;
    hold-trigger-key-positions = <RIGHT_HAND_KEYS THUMB_KEYS>;
    hold-trigger-on-release; // wait for other home row mods
    tapping-term-ms = <LEFT_MIDDY_HOLDING_TIME>;
    quick-tap-ms = <LEFT_MIDDY_REPEAT_DECAY>;
    require-prior-idle-ms = <LEFT_MIDDY_STREAK_DECAY>;
    bindings = <&kp>, <&kp>;
)
#ifdef ENFORCE_BILATERAL
ZMK_BEHAVIOR(left_middy_pinky_bilateral, hold_tap, 
    flavor = LEFT_MIDDY_HOLDING_TYPE;
    hold-trigger-key-positions = <RIGHT_HAND_KEYS THUMB_KEYS>;
    hold-trigger-on-release; // wait for other home row mods
    tapping-term-ms = <LEFT_MIDDY_HOLDING_TIME>;
    quick-tap-ms = <LEFT_MIDDY_REPEAT_DECAY>;
    require-prior-idle-ms = <LEFT_MIDDY_STREAK_DECAY>;
    bindings = <&kp>, <&left_middy_tap>;
)
#endif
#define LeftMiddyPinky left_middy_pinky_bilateral LEFT_PINKY_MOD LEFT_PINKY_KEY
#ifndef LEFT_INDEX_PINKY_HOLDING_TYPE
#define LEFT_INDEX_PINKY_HOLDING_TYPE LEFT_INDEX_CHORD_HOLDING_TYPE
#endif
#ifndef LEFT_INDEX_PINKY_HOLDING_TIME
#define LEFT_INDEX_PINKY_HOLDING_TIME LEFT_INDEX_CHORD_HOLDING_TIME
#endif
#ifndef LEFT_INDEX_PINKY_STREAK_DECAY
#define LEFT_INDEX_PINKY_STREAK_DECAY LEFT_INDEX_CHORD_STREAK_DECAY
#endif
#ifndef LEFT_INDEX_PINKY_REPEAT_DECAY
#define LEFT_INDEX_PINKY_REPEAT_DECAY LEFT_INDEX_CHORD_REPEAT_DECAY
#endif

ZMK_BEHAVIOR(left_index_pinky, hold_tap, 
    flavor = LEFT_INDEX_HOLDING_TYPE;
    hold-trigger-key-positions = <RIGHT_HAND_KEYS THUMB_KEYS>;
    hold-trigger-on-release; // wait for other home row mods
    tapping-term-ms = <LEFT_INDEX_HOLDING_TIME>;
    quick-tap-ms = <LEFT_INDEX_REPEAT_DECAY>;
    require-prior-idle-ms = <LEFT_INDEX_STREAK_DECAY>;
    bindings = <&kp>, <&kp>;
)
#ifdef ENFORCE_BILATERAL
ZMK_BEHAVIOR(left_index_pinky_bilateral, hold_tap, 
    flavor = LEFT_INDEX_HOLDING_TYPE;
    hold-trigger-key-positions = <RIGHT_HAND_KEYS THUMB_KEYS>;
    hold-trigger-on-release; // wait for other home row mods
    tapping-term-ms = <LEFT_INDEX_HOLDING_TIME>;
    quick-tap-ms = <LEFT_INDEX_REPEAT_DECAY>;
    require-prior-idle-ms = <LEFT_INDEX_STREAK_DECAY>;
    bindings = <&kp>, <&left_index_tap>;
)
#endif
#define LeftIndexPinky left_index_pinky_bilateral LEFT_PINKY_MOD LEFT_PINKY_KEY
#ifndef RIGHT_RING_PINKY_HOLDING_TYPE
#define RIGHT_RING_PINKY_HOLDING_TYPE RIGHT_RING_CHORD_HOLDING_TYPE
#endif
#ifndef RIGHT_RING_PINKY_HOLDING_TIME
#define RIGHT_RING_PINKY_HOLDING_TIME RIGHT_RING_CHORD_HOLDING_TIME
#endif
#ifndef RIGHT_RING_PINKY_STREAK_DECAY
#define RIGHT_RING_PINKY_STREAK_DECAY RIGHT_RING_CHORD_STREAK_DECAY
#endif
#ifndef RIGHT_RING_PINKY_REPEAT_DECAY
#define RIGHT_RING_PINKY_REPEAT_DECAY RIGHT_RING_CHORD_REPEAT_DECAY
#endif

ZMK_BEHAVIOR(right_ring_pinky, hold_tap, 
    flavor = RIGHT_RING_HOLDING_TYPE;
    hold-trigger-key-positions = <LEFT_HAND_KEYS THUMB_KEYS>;
    hold-trigger-on-release; // wait for other home row mods
    tapping-term-ms = <RIGHT_RING_HOLDING_TIME>;
    quick-tap-ms = <RIGHT_RING_REPEAT_DECAY>;
    require-prior-idle-ms = <RIGHT_RING_STREAK_DECAY>;
    bindings = <&kp>, <&kp>;
)
#ifdef ENFORCE_BILATERAL
ZMK_BEHAVIOR(right_ring_pinky_bilateral, hold_tap, 
    flavor = RIGHT_RING_HOLDING_TYPE;
    hold-trigger-key-positions = <LEFT_HAND_KEYS THUMB_KEYS>;
    hold-trigger-on-release; // wait for other home row mods
    tapping-term-ms = <RIGHT_RING_HOLDING_TIME>;
    quick-tap-ms = <RIGHT_RING_REPEAT_DECAY>;
    require-prior-idle-ms = <RIGHT_RING_STREAK_DECAY>;
    bindings = <&kp>, <&right_ring_tap>;
)
#endif
#define RightRingPinky right_ring_pinky_bilateral RIGHT_PINKY_MOD RIGHT_PINKY_KEY
#ifndef RIGHT_MIDDY_PINKY_HOLDING_TYPE
#define RIGHT_MIDDY_PINKY_HOLDING_TYPE RIGHT_MIDDY_CHORD_HOLDING_TYPE
#endif
#ifndef RIGHT_MIDDY_PINKY_HOLDING_TIME
#define RIGHT_MIDDY_PINKY_HOLDING_TIME RIGHT_MIDDY_CHORD_HOLDING_TIME
#endif
#ifndef RIGHT_MIDDY_PINKY_STREAK_DECAY
#define RIGHT_MIDDY_PINKY_STREAK_DECAY RIGHT_MIDDY_CHORD_STREAK_DECAY
#endif
#ifndef RIGHT_MIDDY_PINKY_REPEAT_DECAY
#define RIGHT_MIDDY_PINKY_REPEAT_DECAY RIGHT_MIDDY_CHORD_REPEAT_DECAY
#endif

ZMK_BEHAVIOR(right_middy_pinky, hold_tap, 
    flavor = RIGHT_MIDDY_HOLDING_TYPE;
    hold-trigger-key-positions = <LEFT_HAND_KEYS THUMB_KEYS>;
    hold-trigger-on-release; // wait for other home row mods
    tapping-term-ms = <RIGHT_MIDDY_HOLDING_TIME>;
    quick-tap-ms = <RIGHT_MIDDY_REPEAT_DECAY>;
    require-prior-idle-ms = <RIGHT_MIDDY_STREAK_DECAY>;
    bindings = <&kp>, <&kp>;
)
#ifdef ENFORCE_BILATERAL
ZMK_BEHAVIOR(right_middy_pinky_bilateral, hold_tap, 
    flavor = RIGHT_MIDDY_HOLDING_TYPE;
    hold-trigger-key-positions = <LEFT_HAND_KEYS THUMB_KEYS>;
    hold-trigger-on-release; // wait for other home row mods
    tapping-term-ms = <RIGHT_MIDDY_HOLDING_TIME>;
    quick-tap-ms = <RIGHT_MIDDY_REPEAT_DECAY>;
    require-prior-idle-ms = <RIGHT_MIDDY_STREAK_DECAY>;
    bindings = <&kp>, <&right_middy_tap>;
)
#endif
#define RightMiddyPinky right_middy_pinky_bilateral RIGHT_PINKY_MOD RIGHT_PINKY_KEY
#ifndef RIGHT_INDEX_PINKY_HOLDING_TYPE
#define RIGHT_INDEX_PINKY_HOLDING_TYPE RIGHT_INDEX_CHORD_HOLDING_TYPE
#endif
#ifndef RIGHT_INDEX_PINKY_HOLDING_TIME
#define RIGHT_INDEX_PINKY_HOLDING_TIME RIGHT_INDEX_CHORD_HOLDING_TIME
#endif
#ifndef RIGHT_INDEX_PINKY_STREAK_DECAY
#define RIGHT_INDEX_PINKY_STREAK_DECAY RIGHT_INDEX_CHORD_STREAK_DECAY
#endif
#ifndef RIGHT_INDEX_PINKY_REPEAT_DECAY
#define RIGHT_INDEX_PINKY_REPEAT_DECAY RIGHT_INDEX_CHORD_REPEAT_DECAY
#endif

ZMK_BEHAVIOR(right_index_pinky, hold_tap, 
    flavor = RIGHT_INDEX_HOLDING_TYPE;
    hold-trigger-key-positions = <LEFT_HAND_KEYS THUMB_KEYS>;
    hold-trigger-on-release; // wait for other home row mods
    tapping-term-ms = <RIGHT_INDEX_HOLDING_TIME>;
    quick-tap-ms = <RIGHT_INDEX_REPEAT_DECAY>;
    require-prior-idle-ms = <RIGHT_INDEX_STREAK_DECAY>;
    bindings = <&kp>, <&kp>;
)
#ifdef ENFORCE_BILATERAL
ZMK_BEHAVIOR(right_index_pinky_bilateral, hold_tap, 
    flavor = RIGHT_INDEX_HOLDING_TYPE;
    hold-trigger-key-positions = <LEFT_HAND_KEYS THUMB_KEYS>;
    hold-trigger-on-release; // wait for other home row mods
    tapping-term-ms = <RIGHT_INDEX_HOLDING_TIME>;
    quick-tap-ms = <RIGHT_INDEX_REPEAT_DECAY>;
    require-prior-idle-ms = <RIGHT_INDEX_STREAK_DECAY>;
    bindings = <&kp>, <&right_index_tap>;
)
#endif
#define RightIndexPinky right_index_pinky_bilateral RIGHT_PINKY_MOD RIGHT_PINKY_KEY
#ifndef LEFT_PINKY_RING_HOLDING_TYPE
#define LEFT_PINKY_RING_HOLDING_TYPE LEFT_PINKY_CHORD_HOLDING_TYPE
#endif
#ifndef LEFT_PINKY_RING_HOLDING_TIME
#define LEFT_PINKY_RING_HOLDING_TIME LEFT_PINKY_CHORD_HOLDING_TIME
#endif
#ifndef LEFT_PINKY_RING_STREAK_DECAY
#define LEFT_PINKY_RING_STREAK_DECAY LEFT_PINKY_CHORD_STREAK_DECAY
#endif
#ifndef LEFT_PINKY_RING_REPEAT_DECAY
#define LEFT_PINKY_RING_REPEAT_DECAY LEFT_PINKY_CHORD_REPEAT_DECAY
#endif

ZMK_BEHAVIOR(left_pinky_ring, hold_tap, 
    flavor = LEFT_PINKY_HOLDING_TYPE;
    hold-trigger-key-positions = <RIGHT_HAND_KEYS THUMB_KEYS>;
    hold-trigger-on-release; // wait for other home row mods
    tapping-term-ms = <LEFT_PINKY_HOLDING_TIME>;
    quick-tap-ms = <LEFT_PINKY_REPEAT_DECAY>;
    require-prior-idle-ms = <LEFT_PINKY_STREAK_DECAY>;
    bindings = <&kp>, <&kp>;
)
#ifdef ENFORCE_BILATERAL
ZMK_BEHAVIOR(left_pinky_ring_bilateral, hold_tap, 
    flavor = LEFT_PINKY_HOLDING_TYPE;
    hold-trigger-key-positions = <RIGHT_HAND_KEYS THUMB_KEYS>;
    hold-trigger-on-release; // wait for other home row mods
    tapping-term-ms = <LEFT_PINKY_HOLDING_TIME>;
    quick-tap-ms = <LEFT_PINKY_REPEAT_DECAY>;
    require-prior-idle-ms = <LEFT_PINKY_STREAK_DECAY>;
    bindings = <&kp>, <&left_pinky_tap>;
)
#endif
#define LeftPinkyRing left_pinky_ring_bilateral LEFT_RING_MOD LEFT_RING_KEY
#ifndef LEFT_MIDDY_RING_HOLDING_TYPE
#define LEFT_MIDDY_RING_HOLDING_TYPE LEFT_MIDDY_CHORD_HOLDING_TYPE
#endif
#ifndef LEFT_MIDDY_RING_HOLDING_TIME
#define LEFT_MIDDY_RING_HOLDING_TIME LEFT_MIDDY_CHORD_HOLDING_TIME
#endif
#ifndef LEFT_MIDDY_RING_STREAK_DECAY
#define LEFT_MIDDY_RING_STREAK_DECAY LEFT_MIDDY_CHORD_STREAK_DECAY
#endif
#ifndef LEFT_MIDDY_RING_REPEAT_DECAY
#define LEFT_MIDDY_RING_REPEAT_DECAY LEFT_MIDDY_CHORD_REPEAT_DECAY
#endif

ZMK_BEHAVIOR(left_middy_ring, hold_tap, 
    flavor = LEFT_MIDDY_HOLDING_TYPE;
    hold-trigger-key-positions = <RIGHT_HAND_KEYS THUMB_KEYS>;
    hold-trigger-on-release; // wait for other home row mods
    tapping-term-ms = <LEFT_MIDDY_HOLDING_TIME>;
    quick-tap-ms = <LEFT_MIDDY_REPEAT_DECAY>;
    require-prior-idle-ms = <LEFT_MIDDY_STREAK_DECAY>;
    bindings = <&kp>, <&kp>;
)
#ifdef ENFORCE_BILATERAL
ZMK_BEHAVIOR(left_middy_ring_bilateral, hold_tap, 
    flavor = LEFT_MIDDY_HOLDING_TYPE;
    hold-trigger-key-positions = <RIGHT_HAND_KEYS THUMB_KEYS>;
    hold-trigger-on-release; // wait for other home row mods
    tapping-term-ms = <LEFT_MIDDY_HOLDING_TIME>;
    quick-tap-ms = <LEFT_MIDDY_REPEAT_DECAY>;
    require-prior-idle-ms = <LEFT_MIDDY_STREAK_DECAY>;
    bindings = <&kp>, <&left_middy_tap>;
)
#endif
#define LeftMiddyRing left_middy_ring_bilateral LEFT_RING_MOD LEFT_RING_KEY
#ifndef LEFT_INDEX_RING_HOLDING_TYPE
#define LEFT_INDEX_RING_HOLDING_TYPE LEFT_INDEX_CHORD_HOLDING_TYPE
#endif
#ifndef LEFT_INDEX_RING_HOLDING_TIME
#define LEFT_INDEX_RING_HOLDING_TIME LEFT_INDEX_CHORD_HOLDING_TIME
#endif
#ifndef LEFT_INDEX_RING_STREAK_DECAY
#define LEFT_INDEX_RING_STREAK_DECAY LEFT_INDEX_CHORD_STREAK_DECAY
#endif
#ifndef LEFT_INDEX_RING_REPEAT_DECAY
#define LEFT_INDEX_RING_REPEAT_DECAY LEFT_INDEX_CHORD_REPEAT_DECAY
#endif

ZMK_BEHAVIOR(left_index_ring, hold_tap, 
    flavor = LEFT_INDEX_HOLDING_TYPE;
    hold-trigger-key-positions = <RIGHT_HAND_KEYS THUMB_KEYS>;
    hold-trigger-on-release; // wait for other home row mods
    tapping-term-ms = <LEFT_INDEX_HOLDING_TIME>;
    quick-tap-ms = <LEFT_INDEX_REPEAT_DECAY>;
    require-prior-idle-ms = <LEFT_INDEX_STREAK_DECAY>;
    bindings = <&kp>, <&kp>;
)
#ifdef ENFORCE_BILATERAL
ZMK_BEHAVIOR(left_index_ring_bilateral, hold_tap, 
    flavor = LEFT_INDEX_HOLDING_TYPE;
    hold-trigger-key-positions = <RIGHT_HAND_KEYS THUMB_KEYS>;
    hold-trigger-on-release; // wait for other home row mods
    tapping-term-ms = <LEFT_INDEX_HOLDING_TIME>;
    quick-tap-ms = <LEFT_INDEX_REPEAT_DECAY>;
    require-prior-idle-ms = <LEFT_INDEX_STREAK_DECAY>;
    bindings = <&kp>, <&left_index_tap>;
)
#endif
#define LeftIndexRing left_index_ring_bilateral LEFT_RING_MOD LEFT_RING_KEY
#ifndef RIGHT_PINKY_RING_HOLDING_TYPE
#define RIGHT_PINKY_RING_HOLDING_TYPE RIGHT_PINKY_CHORD_HOLDING_TYPE
#endif
#ifndef RIGHT_PINKY_RING_HOLDING_TIME
#define RIGHT_PINKY_RING_HOLDING_TIME RIGHT_PINKY_CHORD_HOLDING_TIME
#endif
#ifndef RIGHT_PINKY_RING_STREAK_DECAY
#define RIGHT_PINKY_RING_STREAK_DECAY RIGHT_PINKY_CHORD_STREAK_DECAY
#endif
#ifndef RIGHT_PINKY_RING_REPEAT_DECAY
#define RIGHT_PINKY_RING_REPEAT_DECAY RIGHT_PINKY_CHORD_REPEAT_DECAY
#endif

ZMK_BEHAVIOR(right_pinky_ring, hold_tap, 
    flavor = RIGHT_PINKY_HOLDING_TYPE;
    hold-trigger-key-positions = <LEFT_HAND_KEYS THUMB_KEYS>;
    hold-trigger-on-release; // wait for other home row mods
    tapping-term-ms = <RIGHT_PINKY_HOLDING_TIME>;
    quick-tap-ms = <RIGHT_PINKY_REPEAT_DECAY>;
    require-prior-idle-ms = <RIGHT_PINKY_STREAK_DECAY>;
    bindings = <&kp>, <&kp>;
)
#ifdef ENFORCE_BILATERAL
ZMK_BEHAVIOR(right_pinky_ring_bilateral, hold_tap, 
    flavor = RIGHT_PINKY_HOLDING_TYPE;
    hold-trigger-key-positions = <LEFT_HAND_KEYS THUMB_KEYS>;
    hold-trigger-on-release; // wait for other home row mods
    tapping-term-ms = <RIGHT_PINKY_HOLDING_TIME>;
    quick-tap-ms = <RIGHT_PINKY_REPEAT_DECAY>;
    require-prior-idle-ms = <RIGHT_PINKY_STREAK_DECAY>;
    bindings = <&kp>, <&right_pinky_tap>;
)
#endif
#define RightPinkyRing right_pinky_ring_bilateral RIGHT_RING_MOD RIGHT_RING_KEY
#ifndef RIGHT_MIDDY_RING_HOLDING_TYPE
#define RIGHT_MIDDY_RING_HOLDING_TYPE RIGHT_MIDDY_CHORD_HOLDING_TYPE
#endif
#ifndef RIGHT_MIDDY_RING_HOLDING_TIME
#define RIGHT_MIDDY_RING_HOLDING_TIME RIGHT_MIDDY_CHORD_HOLDING_TIME
#endif
#ifndef RIGHT_MIDDY_RING_STREAK_DECAY
#define RIGHT_MIDDY_RING_STREAK_DECAY RIGHT_MIDDY_CHORD_STREAK_DECAY
#endif
#ifndef RIGHT_MIDDY_RING_REPEAT_DECAY
#define RIGHT_MIDDY_RING_REPEAT_DECAY RIGHT_MIDDY_CHORD_REPEAT_DECAY
#endif

ZMK_BEHAVIOR(right_middy_ring, hold_tap, 
    flavor = RIGHT_MIDDY_HOLDING_TYPE;
    hold-trigger-key-positions = <LEFT_HAND_KEYS THUMB_KEYS>;
    hold-trigger-on-release; // wait for other home row mods
    tapping-term-ms = <RIGHT_MIDDY_HOLDING_TIME>;
    quick-tap-ms = <RIGHT_MIDDY_REPEAT_DECAY>;
    require-prior-idle-ms = <RIGHT_MIDDY_STREAK_DECAY>;
    bindings = <&kp>, <&kp>;
)
#ifdef ENFORCE_BILATERAL
ZMK_BEHAVIOR(right_middy_ring_bilateral, hold_tap, 
    flavor = RIGHT_MIDDY_HOLDING_TYPE;
    hold-trigger-key-positions = <LEFT_HAND_KEYS THUMB_KEYS>;
    hold-trigger-on-release; // wait for other home row mods
    tapping-term-ms = <RIGHT_MIDDY_HOLDING_TIME>;
    quick-tap-ms = <RIGHT_MIDDY_REPEAT_DECAY>;
    require-prior-idle-ms = <RIGHT_MIDDY_STREAK_DECAY>;
    bindings = <&kp>, <&right_middy_tap>;
)
#endif
#define RightMiddyRing right_middy_ring_bilateral RIGHT_RING_MOD RIGHT_RING_KEY
#ifndef RIGHT_INDEX_RING_HOLDING_TYPE
#define RIGHT_INDEX_RING_HOLDING_TYPE RIGHT_INDEX_CHORD_HOLDING_TYPE
#endif
#ifndef RIGHT_INDEX_RING_HOLDING_TIME
#define RIGHT_INDEX_RING_HOLDING_TIME RIGHT_INDEX_CHORD_HOLDING_TIME
#endif
#ifndef RIGHT_INDEX_RING_STREAK_DECAY
#define RIGHT_INDEX_RING_STREAK_DECAY RIGHT_INDEX_CHORD_STREAK_DECAY
#endif
#ifndef RIGHT_INDEX_RING_REPEAT_DECAY
#define RIGHT_INDEX_RING_REPEAT_DECAY RIGHT_INDEX_CHORD_REPEAT_DECAY
#endif

ZMK_BEHAVIOR(right_index_ring, hold_tap, 
    flavor = RIGHT_INDEX_HOLDING_TYPE;
    hold-trigger-key-positions = <LEFT_HAND_KEYS THUMB_KEYS>;
    hold-trigger-on-release; // wait for other home row mods
    tapping-term-ms = <RIGHT_INDEX_HOLDING_TIME>;
    quick-tap-ms = <RIGHT_INDEX_REPEAT_DECAY>;
    require-prior-idle-ms = <RIGHT_INDEX_STREAK_DECAY>;
    bindings = <&kp>, <&kp>;
)
#ifdef ENFORCE_BILATERAL
ZMK_BEHAVIOR(right_index_ring_bilateral, hold_tap, 
    flavor = RIGHT_INDEX_HOLDING_TYPE;
    hold-trigger-key-positions = <LEFT_HAND_KEYS THUMB_KEYS>;
    hold-trigger-on-release; // wait for other home row mods
    tapping-term-ms = <RIGHT_INDEX_HOLDING_TIME>;
    quick-tap-ms = <RIGHT_INDEX_REPEAT_DECAY>;
    require-prior-idle-ms = <RIGHT_INDEX_STREAK_DECAY>;
    bindings = <&kp>, <&right_index_tap>;
)
#endif
#define RightIndexRing right_index_ring_bilateral RIGHT_RING_MOD RIGHT_RING_KEY
#ifndef LEFT_PINKY_MIDDY_HOLDING_TYPE
#define LEFT_PINKY_MIDDY_HOLDING_TYPE LEFT_PINKY_CHORD_HOLDING_TYPE
#endif
#ifndef LEFT_PINKY_MIDDY_HOLDING_TIME
#define LEFT_PINKY_MIDDY_HOLDING_TIME LEFT_PINKY_CHORD_HOLDING_TIME
#endif
#ifndef LEFT_PINKY_MIDDY_STREAK_DECAY
#define LEFT_PINKY_MIDDY_STREAK_DECAY LEFT_PINKY_CHORD_STREAK_DECAY
#endif
#ifndef LEFT_PINKY_MIDDY_REPEAT_DECAY
#define LEFT_PINKY_MIDDY_REPEAT_DECAY LEFT_PINKY_CHORD_REPEAT_DECAY
#endif

ZMK_BEHAVIOR(left_pinky_middy, hold_tap, 
    flavor = LEFT_PINKY_HOLDING_TYPE;
    hold-trigger-key-positions = <RIGHT_HAND_KEYS THUMB_KEYS>;
    hold-trigger-on-release; // wait for other home row mods
    tapping-term-ms = <LEFT_PINKY_HOLDING_TIME>;
    quick-tap-ms = <LEFT_PINKY_REPEAT_DECAY>;
    require-prior-idle-ms = <LEFT_PINKY_STREAK_DECAY>;
    bindings = <&kp>, <&kp>;
)
#ifdef ENFORCE_BILATERAL
ZMK_BEHAVIOR(left_pinky_middy_bilateral, hold_tap, 
    flavor = LEFT_PINKY_HOLDING_TYPE;
    hold-trigger-key-positions = <RIGHT_HAND_KEYS THUMB_KEYS>;
    hold-trigger-on-release; // wait for other home row mods
    tapping-term-ms = <LEFT_PINKY_HOLDING_TIME>;
    quick-tap-ms = <LEFT_PINKY_REPEAT_DECAY>;
    require-prior-idle-ms = <LEFT_PINKY_STREAK_DECAY>;
    bindings = <&kp>, <&left_pinky_tap>;
)
#endif
#define LeftPinkyMiddy left_pinky_middy_bilateral LEFT_MIDDY_MOD LEFT_MIDDY_KEY
#ifndef LEFT_RING_MIDDY_HOLDING_TYPE
#define LEFT_RING_MIDDY_HOLDING_TYPE LEFT_RING_CHORD_HOLDING_TYPE
#endif
#ifndef LEFT_RING_MIDDY_HOLDING_TIME
#define LEFT_RING_MIDDY_HOLDING_TIME LEFT_RING_CHORD_HOLDING_TIME
#endif
#ifndef LEFT_RING_MIDDY_STREAK_DECAY
#define LEFT_RING_MIDDY_STREAK_DECAY LEFT_RING_CHORD_STREAK_DECAY
#endif
#ifndef LEFT_RING_MIDDY_REPEAT_DECAY
#define LEFT_RING_MIDDY_REPEAT_DECAY LEFT_RING_CHORD_REPEAT_DECAY
#endif

ZMK_BEHAVIOR(left_ring_middy, hold_tap, 
    flavor = LEFT_RING_HOLDING_TYPE;
    hold-trigger-key-positions = <RIGHT_HAND_KEYS THUMB_KEYS>;
    hold-trigger-on-release; // wait for other home row mods
    tapping-term-ms = <LEFT_RING_HOLDING_TIME>;
    quick-tap-ms = <LEFT_RING_REPEAT_DECAY>;
    require-prior-idle-ms = <LEFT_RING_STREAK_DECAY>;
    bindings = <&kp>, <&kp>;
)
#ifdef ENFORCE_BILATERAL
ZMK_BEHAVIOR(left_ring_middy_bilateral, hold_tap, 
    flavor = LEFT_RING_HOLDING_TYPE;
    hold-trigger-key-positions = <RIGHT_HAND_KEYS THUMB_KEYS>;
    hold-trigger-on-release; // wait for other home row mods
    tapping-term-ms = <LEFT_RING_HOLDING_TIME>;
    quick-tap-ms = <LEFT_RING_REPEAT_DECAY>;
    require-prior-idle-ms = <LEFT_RING_STREAK_DECAY>;
    bindings = <&kp>, <&left_ring_tap>;
)
#endif
#define LeftRingMiddy left_ring_middy_bilateral LEFT_MIDDY_MOD LEFT_MIDDY_KEY
#ifndef LEFT_INDEX_MIDDY_HOLDING_TYPE
#define LEFT_INDEX_MIDDY_HOLDING_TYPE LEFT_INDEX_CHORD_HOLDING_TYPE
#endif
#ifndef LEFT_INDEX_MIDDY_HOLDING_TIME
#define LEFT_INDEX_MIDDY_HOLDING_TIME LEFT_INDEX_CHORD_HOLDING_TIME
#endif
#ifndef LEFT_INDEX_MIDDY_STREAK_DECAY
#define LEFT_INDEX_MIDDY_STREAK_DECAY LEFT_INDEX_CHORD_STREAK_DECAY
#endif
#ifndef LEFT_INDEX_MIDDY_REPEAT_DECAY
#define LEFT_INDEX_MIDDY_REPEAT_DECAY LEFT_INDEX_CHORD_REPEAT_DECAY
#endif

ZMK_BEHAVIOR(left_index_middy, hold_tap, 
    flavor = LEFT_INDEX_HOLDING_TYPE;
    hold-trigger-key-positions = <RIGHT_HAND_KEYS THUMB_KEYS>;
    hold-trigger-on-release; // wait for other home row mods
    tapping-term-ms = <LEFT_INDEX_HOLDING_TIME>;
    quick-tap-ms = <LEFT_INDEX_REPEAT_DECAY>;
    require-prior-idle-ms = <LEFT_INDEX_STREAK_DECAY>;
    bindings = <&kp>, <&kp>;
)
#ifdef ENFORCE_BILATERAL
ZMK_BEHAVIOR(left_index_middy_bilateral, hold_tap, 
    flavor = LEFT_INDEX_HOLDING_TYPE;
    hold-trigger-key-positions = <RIGHT_HAND_KEYS THUMB_KEYS>;
    hold-trigger-on-release; // wait for other home row mods
    tapping-term-ms = <LEFT_INDEX_HOLDING_TIME>;
    quick-tap-ms = <LEFT_INDEX_REPEAT_DECAY>;
    require-prior-idle-ms = <LEFT_INDEX_STREAK_DECAY>;
    bindings = <&kp>, <&left_index_tap>;
)
#endif
#define LeftIndexMiddy left_index_middy_bilateral LEFT_MIDDY_MOD LEFT_MIDDY_KEY
#ifndef RIGHT_PINKY_MIDDY_HOLDING_TYPE
#define RIGHT_PINKY_MIDDY_HOLDING_TYPE RIGHT_PINKY_CHORD_HOLDING_TYPE
#endif
#ifndef RIGHT_PINKY_MIDDY_HOLDING_TIME
#define RIGHT_PINKY_MIDDY_HOLDING_TIME RIGHT_PINKY_CHORD_HOLDING_TIME
#endif
#ifndef RIGHT_PINKY_MIDDY_STREAK_DECAY
#define RIGHT_PINKY_MIDDY_STREAK_DECAY RIGHT_PINKY_CHORD_STREAK_DECAY
#endif
#ifndef RIGHT_PINKY_MIDDY_REPEAT_DECAY
#define RIGHT_PINKY_MIDDY_REPEAT_DECAY RIGHT_PINKY_CHORD_REPEAT_DECAY
#endif

ZMK_BEHAVIOR(right_pinky_middy, hold_tap, 
    flavor = RIGHT_PINKY_HOLDING_TYPE;
    hold-trigger-key-positions = <LEFT_HAND_KEYS THUMB_KEYS>;
    hold-trigger-on-release; // wait for other home row mods
    tapping-term-ms = <RIGHT_PINKY_HOLDING_TIME>;
    quick-tap-ms = <RIGHT_PINKY_REPEAT_DECAY>;
    require-prior-idle-ms = <RIGHT_PINKY_STREAK_DECAY>;
    bindings = <&kp>, <&kp>;
)
#ifdef ENFORCE_BILATERAL
ZMK_BEHAVIOR(right_pinky_middy_bilateral, hold_tap, 
    flavor = RIGHT_PINKY_HOLDING_TYPE;
    hold-trigger-key-positions = <LEFT_HAND_KEYS THUMB_KEYS>;
    hold-trigger-on-release; // wait for other home row mods
    tapping-term-ms = <RIGHT_PINKY_HOLDING_TIME>;
    quick-tap-ms = <RIGHT_PINKY_REPEAT_DECAY>;
    require-prior-idle-ms = <RIGHT_PINKY_STREAK_DECAY>;
    bindings = <&kp>, <&right_pinky_tap>;
)
#endif
#define RightPinkyMiddy right_pinky_middy_bilateral RIGHT_MIDDY_MOD RIGHT_MIDDY_KEY
#ifndef RIGHT_RING_MIDDY_HOLDING_TYPE
#define RIGHT_RING_MIDDY_HOLDING_TYPE RIGHT_RING_CHORD_HOLDING_TYPE
#endif
#ifndef RIGHT_RING_MIDDY_HOLDING_TIME
#define RIGHT_RING_MIDDY_HOLDING_TIME RIGHT_RING_CHORD_HOLDING_TIME
#endif
#ifndef RIGHT_RING_MIDDY_STREAK_DECAY
#define RIGHT_RING_MIDDY_STREAK_DECAY RIGHT_RING_CHORD_STREAK_DECAY
#endif
#ifndef RIGHT_RING_MIDDY_REPEAT_DECAY
#define RIGHT_RING_MIDDY_REPEAT_DECAY RIGHT_RING_CHORD_REPEAT_DECAY
#endif

ZMK_BEHAVIOR(right_ring_middy, hold_tap, 
    flavor = RIGHT_RING_HOLDING_TYPE;
    hold-trigger-key-positions = <LEFT_HAND_KEYS THUMB_KEYS>;
    hold-trigger-on-release; // wait for other home row mods
    tapping-term-ms = <RIGHT_RING_HOLDING_TIME>;
    quick-tap-ms = <RIGHT_RING_REPEAT_DECAY>;
    require-prior-idle-ms = <RIGHT_RING_STREAK_DECAY>;
    bindings = <&kp>, <&kp>;
)
#ifdef ENFORCE_BILATERAL
ZMK_BEHAVIOR(right_ring_middy_bilateral, hold_tap, 
    flavor = RIGHT_RING_HOLDING_TYPE;
    hold-trigger-key-positions = <LEFT_HAND_KEYS THUMB_KEYS>;
    hold-trigger-on-release; // wait for other home row mods
    tapping-term-ms = <RIGHT_RING_HOLDING_TIME>;
    quick-tap-ms = <RIGHT_RING_REPEAT_DECAY>;
    require-prior-idle-ms = <RIGHT_RING_STREAK_DECAY>;
    bindings = <&kp>, <&right_ring_tap>;
)
#endif
#define RightRingMiddy right_ring_middy_bilateral RIGHT_MIDDY_MOD RIGHT_MIDDY_KEY
#ifndef RIGHT_INDEX_MIDDY_HOLDING_TYPE
#define RIGHT_INDEX_MIDDY_HOLDING_TYPE RIGHT_INDEX_CHORD_HOLDING_TYPE
#endif
#ifndef RIGHT_INDEX_MIDDY_HOLDING_TIME
#define RIGHT_INDEX_MIDDY_HOLDING_TIME RIGHT_INDEX_CHORD_HOLDING_TIME
#endif
#ifndef RIGHT_INDEX_MIDDY_STREAK_DECAY
#define RIGHT_INDEX_MIDDY_STREAK_DECAY RIGHT_INDEX_CHORD_STREAK_DECAY
#endif
#ifndef RIGHT_INDEX_MIDDY_REPEAT_DECAY
#define RIGHT_INDEX_MIDDY_REPEAT_DECAY RIGHT_INDEX_CHORD_REPEAT_DECAY
#endif

ZMK_BEHAVIOR(right_index_middy, hold_tap, 
    flavor = RIGHT_INDEX_HOLDING_TYPE;
    hold-trigger-key-positions = <LEFT_HAND_KEYS THUMB_KEYS>;
    hold-trigger-on-release; // wait for other home row mods
    tapping-term-ms = <RIGHT_INDEX_HOLDING_TIME>;
    quick-tap-ms = <RIGHT_INDEX_REPEAT_DECAY>;
    require-prior-idle-ms = <RIGHT_INDEX_STREAK_DECAY>;
    bindings = <&kp>, <&kp>;
)
#ifdef ENFORCE_BILATERAL
ZMK_BEHAVIOR(right_index_middy_bilateral, hold_tap, 
    flavor = RIGHT_INDEX_HOLDING_TYPE;
    hold-trigger-key-positions = <LEFT_HAND_KEYS THUMB_KEYS>;
    hold-trigger-on-release; // wait for other home row mods
    tapping-term-ms = <RIGHT_INDEX_HOLDING_TIME>;
    quick-tap-ms = <RIGHT_INDEX_REPEAT_DECAY>;
    require-prior-idle-ms = <RIGHT_INDEX_STREAK_DECAY>;
    bindings = <&kp>, <&right_index_tap>;
)
#endif
#define RightIndexMiddy right_index_middy_bilateral RIGHT_MIDDY_MOD RIGHT_MIDDY_KEY
#ifndef LEFT_PINKY_INDEX_HOLDING_TYPE
#define LEFT_PINKY_INDEX_HOLDING_TYPE LEFT_PINKY_CHORD_HOLDING_TYPE
#endif
#ifndef LEFT_PINKY_INDEX_HOLDING_TIME
#define LEFT_PINKY_INDEX_HOLDING_TIME LEFT_PINKY_CHORD_HOLDING_TIME
#endif
#ifndef LEFT_PINKY_INDEX_STREAK_DECAY
#define LEFT_PINKY_INDEX_STREAK_DECAY LEFT_PINKY_CHORD_STREAK_DECAY
#endif
#ifndef LEFT_PINKY_INDEX_REPEAT_DECAY
#define LEFT_PINKY_INDEX_REPEAT_DECAY LEFT_PINKY_CHORD_REPEAT_DECAY
#endif

ZMK_BEHAVIOR(left_pinky_index, hold_tap, 
    flavor = LEFT_PINKY_HOLDING_TYPE;
    hold-trigger-key-positions = <RIGHT_HAND_KEYS THUMB_KEYS>;
    hold-trigger-on-release; // wait for other home row mods
    tapping-term-ms = <LEFT_PINKY_HOLDING_TIME>;
    quick-tap-ms = <LEFT_PINKY_REPEAT_DECAY>;
    require-prior-idle-ms = <LEFT_PINKY_STREAK_DECAY>;
    bindings = <&kp>, <&kp>;
)
#ifdef ENFORCE_BILATERAL
ZMK_BEHAVIOR(left_pinky_index_bilateral, hold_tap, 
    flavor = LEFT_PINKY_HOLDING_TYPE;
    hold-trigger-key-positions = <RIGHT_HAND_KEYS THUMB_KEYS>;
    hold-trigger-on-release; // wait for other home row mods
    tapping-term-ms = <LEFT_PINKY_HOLDING_TIME>;
    quick-tap-ms = <LEFT_PINKY_REPEAT_DECAY>;
    require-prior-idle-ms = <LEFT_PINKY_STREAK_DECAY>;
    bindings = <&kp>, <&left_pinky_tap>;
)
#endif
#define LeftPinkyIndex left_pinky_index_bilateral LEFT_INDEX_MOD LEFT_INDEX_KEY
#ifndef LEFT_RING_INDEX_HOLDING_TYPE
#define LEFT_RING_INDEX_HOLDING_TYPE LEFT_RING_CHORD_HOLDING_TYPE
#endif
#ifndef LEFT_RING_INDEX_HOLDING_TIME
#define LEFT_RING_INDEX_HOLDING_TIME LEFT_RING_CHORD_HOLDING_TIME
#endif
#ifndef LEFT_RING_INDEX_STREAK_DECAY
#define LEFT_RING_INDEX_STREAK_DECAY LEFT_RING_CHORD_STREAK_DECAY
#endif
#ifndef LEFT_RING_INDEX_REPEAT_DECAY
#define LEFT_RING_INDEX_REPEAT_DECAY LEFT_RING_CHORD_REPEAT_DECAY
#endif

ZMK_BEHAVIOR(left_ring_index, hold_tap, 
    flavor = LEFT_RING_HOLDING_TYPE;
    hold-trigger-key-positions = <RIGHT_HAND_KEYS THUMB_KEYS>;
    hold-trigger-on-release; // wait for other home row mods
    tapping-term-ms = <LEFT_RING_HOLDING_TIME>;
    quick-tap-ms = <LEFT_RING_REPEAT_DECAY>;
    require-prior-idle-ms = <LEFT_RING_STREAK_DECAY>;
    bindings = <&kp>, <&kp>;
)
#ifdef ENFORCE_BILATERAL
ZMK_BEHAVIOR(left_ring_index_bilateral, hold_tap, 
    flavor = LEFT_RING_HOLDING_TYPE;
    hold-trigger-key-positions = <RIGHT_HAND_KEYS THUMB_KEYS>;
    hold-trigger-on-release; // wait for other home row mods
    tapping-term-ms = <LEFT_RING_HOLDING_TIME>;
    quick-tap-ms = <LEFT_RING_REPEAT_DECAY>;
    require-prior-idle-ms = <LEFT_RING_STREAK_DECAY>;
    bindings = <&kp>, <&left_ring_tap>;
)
#endif
#define LeftRingIndex left_ring_index_bilateral LEFT_INDEX_MOD LEFT_INDEX_KEY
#ifndef LEFT_MIDDY_INDEX_HOLDING_TYPE
#define LEFT_MIDDY_INDEX_HOLDING_TYPE LEFT_MIDDY_CHORD_HOLDING_TYPE
#endif
#ifndef LEFT_MIDDY_INDEX_HOLDING_TIME
#define LEFT_MIDDY_INDEX_HOLDING_TIME LEFT_MIDDY_CHORD_HOLDING_TIME
#endif
#ifndef LEFT_MIDDY_INDEX_STREAK_DECAY
#define LEFT_MIDDY_INDEX_STREAK_DECAY LEFT_MIDDY_CHORD_STREAK_DECAY
#endif
#ifndef LEFT_MIDDY_INDEX_REPEAT_DECAY
#define LEFT_MIDDY_INDEX_REPEAT_DECAY LEFT_MIDDY_CHORD_REPEAT_DECAY
#endif

ZMK_BEHAVIOR(left_middy_index, hold_tap, 
    flavor = LEFT_MIDDY_HOLDING_TYPE;
    hold-trigger-key-positions = <RIGHT_HAND_KEYS THUMB_KEYS>;
    hold-trigger-on-release; // wait for other home row mods
    tapping-term-ms = <LEFT_MIDDY_HOLDING_TIME>;
    quick-tap-ms = <LEFT_MIDDY_REPEAT_DECAY>;
    require-prior-idle-ms = <LEFT_MIDDY_STREAK_DECAY>;
    bindings = <&kp>, <&kp>;
)
#ifdef ENFORCE_BILATERAL
ZMK_BEHAVIOR(left_middy_index_bilateral, hold_tap, 
    flavor = LEFT_MIDDY_HOLDING_TYPE;
    hold-trigger-key-positions = <RIGHT_HAND_KEYS THUMB_KEYS>;
    hold-trigger-on-release; // wait for other home row mods
    tapping-term-ms = <LEFT_MIDDY_HOLDING_TIME>;
    quick-tap-ms = <LEFT_MIDDY_REPEAT_DECAY>;
    require-prior-idle-ms = <LEFT_MIDDY_STREAK_DECAY>;
    bindings = <&kp>, <&left_middy_tap>;
)
#endif
#define LeftMiddyIndex left_middy_index_bilateral LEFT_INDEX_MOD LEFT_INDEX_KEY
#ifndef RIGHT_PINKY_INDEX_HOLDING_TYPE
#define RIGHT_PINKY_INDEX_HOLDING_TYPE RIGHT_PINKY_CHORD_HOLDING_TYPE
#endif
#ifndef RIGHT_PINKY_INDEX_HOLDING_TIME
#define RIGHT_PINKY_INDEX_HOLDING_TIME RIGHT_PINKY_CHORD_HOLDING_TIME
#endif
#ifndef RIGHT_PINKY_INDEX_STREAK_DECAY
#define RIGHT_PINKY_INDEX_STREAK_DECAY RIGHT_PINKY_CHORD_STREAK_DECAY
#endif
#ifndef RIGHT_PINKY_INDEX_REPEAT_DECAY
#define RIGHT_PINKY_INDEX_REPEAT_DECAY RIGHT_PINKY_CHORD_REPEAT_DECAY
#endif

ZMK_BEHAVIOR(right_pinky_index, hold_tap, 
    flavor = RIGHT_PINKY_HOLDING_TYPE;
    hold-trigger-key-positions = <LEFT_HAND_KEYS THUMB_KEYS>;
    hold-trigger-on-release; // wait for other home row mods
    tapping-term-ms = <RIGHT_PINKY_HOLDING_TIME>;
    quick-tap-ms = <RIGHT_PINKY_REPEAT_DECAY>;
    require-prior-idle-ms = <RIGHT_PINKY_STREAK_DECAY>;
    bindings = <&kp>, <&kp>;
)
#ifdef ENFORCE_BILATERAL
ZMK_BEHAVIOR(right_pinky_index_bilateral, hold_tap, 
    flavor = RIGHT_PINKY_HOLDING_TYPE;
    hold-trigger-key-positions = <LEFT_HAND_KEYS THUMB_KEYS>;
    hold-trigger-on-release; // wait for other home row mods
    tapping-term-ms = <RIGHT_PINKY_HOLDING_TIME>;
    quick-tap-ms = <RIGHT_PINKY_REPEAT_DECAY>;
    require-prior-idle-ms = <RIGHT_PINKY_STREAK_DECAY>;
    bindings = <&kp>, <&right_pinky_tap>;
)
#endif
#define RightPinkyIndex right_pinky_index_bilateral RIGHT_INDEX_MOD RIGHT_INDEX_KEY
#ifndef RIGHT_RING_INDEX_HOLDING_TYPE
#define RIGHT_RING_INDEX_HOLDING_TYPE RIGHT_RING_CHORD_HOLDING_TYPE
#endif
#ifndef RIGHT_RING_INDEX_HOLDING_TIME
#define RIGHT_RING_INDEX_HOLDING_TIME RIGHT_RING_CHORD_HOLDING_TIME
#endif
#ifndef RIGHT_RING_INDEX_STREAK_DECAY
#define RIGHT_RING_INDEX_STREAK_DECAY RIGHT_RING_CHORD_STREAK_DECAY
#endif
#ifndef RIGHT_RING_INDEX_REPEAT_DECAY
#define RIGHT_RING_INDEX_REPEAT_DECAY RIGHT_RING_CHORD_REPEAT_DECAY
#endif

ZMK_BEHAVIOR(right_ring_index, hold_tap, 
    flavor = RIGHT_RING_HOLDING_TYPE;
    hold-trigger-key-positions = <LEFT_HAND_KEYS THUMB_KEYS>;
    hold-trigger-on-release; // wait for other home row mods
    tapping-term-ms = <RIGHT_RING_HOLDING_TIME>;
    quick-tap-ms = <RIGHT_RING_REPEAT_DECAY>;
    require-prior-idle-ms = <RIGHT_RING_STREAK_DECAY>;
    bindings = <&kp>, <&kp>;
)
#ifdef ENFORCE_BILATERAL
ZMK_BEHAVIOR(right_ring_index_bilateral, hold_tap, 
    flavor = RIGHT_RING_HOLDING_TYPE;
    hold-trigger-key-positions = <LEFT_HAND_KEYS THUMB_KEYS>;
    hold-trigger-on-release; // wait for other home row mods
    tapping-term-ms = <RIGHT_RING_HOLDING_TIME>;
    quick-tap-ms = <RIGHT_RING_REPEAT_DECAY>;
    require-prior-idle-ms = <RIGHT_RING_STREAK_DECAY>;
    bindings = <&kp>, <&right_ring_tap>;
)
#endif
#define RightRingIndex right_ring_index_bilateral RIGHT_INDEX_MOD RIGHT_INDEX_KEY
#ifndef RIGHT_MIDDY_INDEX_HOLDING_TYPE
#define RIGHT_MIDDY_INDEX_HOLDING_TYPE RIGHT_MIDDY_CHORD_HOLDING_TYPE
#endif
#ifndef RIGHT_MIDDY_INDEX_HOLDING_TIME
#define RIGHT_MIDDY_INDEX_HOLDING_TIME RIGHT_MIDDY_CHORD_HOLDING_TIME
#endif
#ifndef RIGHT_MIDDY_INDEX_STREAK_DECAY
#define RIGHT_MIDDY_INDEX_STREAK_DECAY RIGHT_MIDDY_CHORD_STREAK_DECAY
#endif
#ifndef RIGHT_MIDDY_INDEX_REPEAT_DECAY
#define RIGHT_MIDDY_INDEX_REPEAT_DECAY RIGHT_MIDDY_CHORD_REPEAT_DECAY
#endif

ZMK_BEHAVIOR(right_middy_index, hold_tap, 
    flavor = RIGHT_MIDDY_HOLDING_TYPE;
    hold-trigger-key-positions = <LEFT_HAND_KEYS THUMB_KEYS>;
    hold-trigger-on-release; // wait for other home row mods
    tapping-term-ms = <RIGHT_MIDDY_HOLDING_TIME>;
    quick-tap-ms = <RIGHT_MIDDY_REPEAT_DECAY>;
    require-prior-idle-ms = <RIGHT_MIDDY_STREAK_DECAY>;
    bindings = <&kp>, <&kp>;
)
#ifdef ENFORCE_BILATERAL
ZMK_BEHAVIOR(right_middy_index_bilateral, hold_tap, 
    flavor = RIGHT_MIDDY_HOLDING_TYPE;
    hold-trigger-key-positions = <LEFT_HAND_KEYS THUMB_KEYS>;
    hold-trigger-on-release; // wait for other home row mods
    tapping-term-ms = <RIGHT_MIDDY_HOLDING_TIME>;
    quick-tap-ms = <RIGHT_MIDDY_REPEAT_DECAY>;
    require-prior-idle-ms = <RIGHT_MIDDY_STREAK_DECAY>;
    bindings = <&kp>, <&right_middy_tap>;
)
#endif
#define RightMiddyIndex right_middy_index_bilateral RIGHT_INDEX_MOD RIGHT_INDEX_KEY

// ---

//
// Keymap specific knowledge of the base layer's alpha + ZMK layout
//
#define LH_C6R1 GRAVE
#define LH_C5R1 1
#define LH_C4R1 2
#define LH_C3R1 3
#define LH_C2R1 4
#define LH_C1R1 5
#define RH_C1R1 6
#define RH_C2R1 7
#define RH_C3R1 8
#define RH_C4R1 9
#define RH_C5R1 0
#define RH_C6R1 EQUAL

#define LH_C6R2 TAB
#define LH_C5R2 Q
#define LH_C4R2 W
#define LH_C3R2 F
#define LH_C2R2 P
#define LH_C1R2 G
#define RH_C1R2 J
#define RH_C2R2 L
#define RH_C3R2 U
#define RH_C4R2 Y
#define RH_C5R2 SEMI
#define RH_C6R2 MINUS

#define LH_C6R3 ESC
#define LH_C5R3 A
#define LH_C4R3 R
#define LH_C3R3 S
#define LH_C2R3 T
#define LH_C1R3 D
#define RH_C1R3 H
#define RH_C2R3 N
#define RH_C3R3 E
#define RH_C4R3 I
#define RH_C5R3 O
#define RH_C6R3 SQT

#define LH_C6R4 LSHFT
#define LH_C5R4 Z
#define LH_C4R4 X
#define LH_C3R4 C
#define LH_C2R4 V
#define LH_C1R4 B
#define RH_C1R4 K
#define RH_C2R4 M
#define RH_C3R4 COMMA
#define RH_C4R4 DOT
#define RH_C5R4 FSLH
#define RH_C6R4 RSHFT

#define HOME_ROW_left_pinky_tap &none &LeftPinkyRing &LeftPinkyMiddy &LeftPinkyIndex &left_pinky_tap LH_C1R3 &RightPlainKey &kp RIGHT_INDEX_KEY &kp RIGHT_MIDDY_KEY &kp RIGHT_RING_KEY  &kp RIGHT_PINKY_KEY
#define HOME_ROW_left_ring_tap &LeftRingPinky &none &LeftRingMiddy &LeftRingIndex &left_ring_tap LH_C1R4 &RightPlainKey &kp RIGHT_INDEX_KEY &kp RIGHT_MIDDY_KEY &kp RIGHT_RING_KEY &kp RIGHT_PINKY_KEY
#define HOME_ROW_left_middy_tap &LeftMiddyPinky &LeftMiddyRing &none &LeftMiddyIndex &left_middy_tap LH_C1R4 &RightPlainKey &kp RIGHT_INDEX_KEY &kp RIGHT_MIDDY_KEY &kp RIGHT_RING_KEY &kp RIGHT_PINKY_KEY
#define HOME_ROW_left_index_tap &LeftIndexPinky &LeftIndexRing &LeftIndexMiddy &none &left_index_tap LH_C1R4 &RightPlainKey &kp RIGHT_INDEX_KEY &kp RIGHT_MIDDY_KEY &kp RIGHT_RING_KEY &kp RIGHT_PINKY_KEY

#define HOME_ROW_right_pinky_tap  &kp LEFT_PINKY_KEY  &kp LEFT_RING_KEY  &kp LEFT_MIDDY_KEY  &kp LEFT_INDEX_KEY  &LeftPlainKey &right_pinky_tap RH_C1R4 &RightPinkyIndex &RightPinkyMiddy &RightPinkyRing &none
#define HOME_ROW_right_ring_tap &kp LEFT_PINKY_KEY &kp LEFT_RING_KEY &kp LEFT_MIDDY_KEY &kp LEFT_INDEX_KEY &LeftPlainKey &right_ring_tap RH_C1R4 &RightRingIndex &RightRingMiddy &none &RightRingPinky
#define HOME_ROW_right_middy_tap &kp LEFT_PINKY_KEY &kp LEFT_RING_KEY &kp LEFT_MIDDY_KEY &kp LEFT_INDEX_KEY &LeftPlainKey &right_middy_tap RH_C1R4 &RightMiddyIndex &none &RightMiddyRing &RightMiddyPinky
#define HOME_ROW_right_index_tap &kp LEFT_PINKY_KEY &kp LEFT_RING_KEY &kp LEFT_MIDDY_KEY &kp LEFT_INDEX_KEY &LeftPlainKey &right_index_tap RH_C1R4 &none &RightIndexMiddy &RightIndexRing &RightIndexPinky
#define HOME_ROW(finger)  HOME_ROW_##finger


#define BILATERAL_LAYER_LEFT(finger) \
        layer_ ## finger { \
            bindings = < \
  &finger LH_C6R1    &finger LH_C5R1   &finger LH_C4R1   &finger LH_C3R1   &finger LH_C2R1   &finger LH_C1R1                         &trans   &trans   &trans   &trans   &trans   &trans \
  &trans             &finger LH_C5R2   &finger LH_C4R2   &finger LH_C3R2   &finger LH_C2R2   &finger LH_C1R2                         &trans   &trans   &trans   &trans   &trans   &trans \
  &trans             HOME_ROW(finger)                                                                                                                                             &trans \
  &trans             &mo LAYER_LHN     &finger LH_C4R4   &finger LH_C3R4   &finger LH_C2R4   &finger LH_C1R4                         &trans   &trans   &trans   &trans   &trans   &trans \
                             &trans   &trans   &trans   &trans                &trans   &trans   &trans   &trans                             \
            >; \
        }

#define BILATERAL_LAYER_RIGHT(finger) \
        layer_ ## finger { \
            bindings = < \
&trans   &trans   &trans   &trans   &trans   &trans                         &finger RH_C1R1    &finger RH_C2R1   &finger RH_C3R1   &finger RH_C4R1   &finger RH_C5R1   &finger RH_C6R1 \
&trans   &trans   &trans   &trans   &trans   &trans                         &trans             &finger RH_C2R2   &finger RH_C3R2   &finger RH_C4R2   &finger RH_C5R2   &finger RH_C6R2 \
&trans                                                                                         HOME_ROW(finger)                                                        &trans          \
&trans   &trans   &trans   &trans   &trans   &trans   &trans       &trans   &trans             &finger RH_C2R4   &finger RH_C3R4   &finger RH_C4R4   &mo LAYER_RHN   &finger RH_C6R4 \
                           &trans   &trans   &trans   &trans       &trans   &trans   &trans   &trans                             \
            >; \
        }
